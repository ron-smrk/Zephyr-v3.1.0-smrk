## Kconfig
```
# Config options for logger sample app

# Copyright (c) 2018 Nordic Semiconductor ASA
# SPDX-License-Identifier: Apache-2.0

mainmenu "Logger sample application"

menu "Application configuration"

config SHELL_FOREGROUND_CMDS
	bool "Shell foreground commands example"
	default y

config SHELL_DYNAMIC_CMDS
	bool "Shell dynamic commands example"
	default n

endmenu

source "Kconfig.zephyr"
```

## prj.conf
```kconfig
CONFIG_PRINTK=y
CONFIG_SHELL=y
CONFIG_LOG=y
CONFIG_INIT_STACKS=y
CONFIG_THREAD_STACK_INFO=y
CONFIG_KERNEL_SHELL=y
CONFIG_THREAD_MONITOR=y
CONFIG_BOOT_BANNER=n
CONFIG_THREAD_NAME=y
CONFIG_DEVICE_SHELL=y
CONFIG_POSIX_CLOCK=y
CONFIG_DATE_SHELL=y
CONFIG_THREAD_RUNTIME_STATS=y
CONFIG_THREAD_RUNTIME_STATS_USE_TIMING_FUNCTIONS=y
CONFIG_STATS=y
CONFIG_STATS_SHELL=y

CONFIG_GPIO=y
CONFIG_I2C=y
 
CONFIG_I2C_SHELL=y
 
#CONFIG_SENSOR_SHELL=y
#CONFIG_SENSOR=y

CONFIG_RAM_CONSOLE=y
CONFIG_MINIMAL_LIBC_MALLOC_ARENA_SIZE=1024

CONFIG_MCUMGR=y
# Some command handlers require a large stack.
CONFIG_SYSTEM_WORKQUEUE_STACK_SIZE=2304
CONFIG_MAIN_STACK_SIZE=2048

CONFIG_BOOTLOADER_MCUBOOT=y

# # Enable flash operations.
CONFIG_FLASH=y

# # Required by the `taskstat` command.
CONFIG_THREAD_MONITOR=y

# # Support for taskstat command
#CONFIG_OS_MGMT_TASKSTAT=y

# # Enable statistics and statistic names.
CONFIG_STATS=y
CONFIG_STATS_NAMES=y

# # Enable most core commands.
CONFIG_MCUMGR_CMD_IMG_MGMT=y
CONFIG_MCUMGR_CMD_OS_MGMT=y
CONFIG_MCUMGR_CMD_STAT_MGMT=y

# # Enable logging
# CONFIG_LOG=y
# CONFIG_MCUBOOT_UTIL_LOG_LEVEL_WRN=y

# # Enable the serial mcumgr transport.
#CONFIG_UART_MCUMGR=y
CONFIG_MCUMGR_SMP_UART=y

# # Enable the LittleFS file system.
# CONFIG_FILE_SYSTEM=y
# CONFIG_FILE_SYSTEM_LITTLEFS=y

# # Add 256 bytes to accommodate upload command (lfs_stat overflows)
# CONFIG_SYSTEM_WORKQUEUE_STACK_SIZE=2304

# # Enable file system commands
CONFIG_MCUMGR_CMD_FS_MGMT=y

CONFIG_SHELL_BACKEND_SERIAL=n
CONFIG_MCUMGR_CMD_SHELL_MGMT=y

# CONFIG_CONSOLE=y
CONFIG_UART_CONSOLE=y
CONFIG_UART_CONSOLE_MCUMGR=y
```

## src/main.c
```c
/*
 * Copyright (c) 2015 Intel Corporation
 *
 * SPDX-License-Identifier: Apache-2.0
 */

#include <zephyr/zephyr.h>
#include <zephyr/shell/shell.h>
#include <version.h>
#include <zephyr/logging/log.h>
#include <stdlib.h>
#include <zephyr/drivers/uart.h>
#include <zephyr/usb/usb_device.h>
#include <ctype.h>
#include "lib.h"

LOG_MODULE_REGISTER(app);

#if defined CONFIG_SHELL_GETOPT
/* Thread save usage */
static int cmd_demo_getopt_ts(const struct shell *sh, size_t argc,
			      char **argv)
{
	struct getopt_state *state;
	char *cvalue = NULL;
	int aflag = 0;
	int bflag = 0;
	int c;

	while ((c = getopt(argc, argv, "abhc:")) != -1) {
		state = getopt_state_get();
		switch (c) {
		case 'a':
			aflag = 1;
			break;
		case 'b':
			bflag = 1;
			break;
		case 'c':
			cvalue = state->optarg;
			break;
		case 'h':
			/* When getopt is active shell is not parsing
			 * command handler to print help message. It must
			 * be done explicitly.
			 */
			shell_help(sh);
			return SHELL_CMD_HELP_PRINTED;
		case '?':
			if (state->optopt == 'c') {
				shell_print(sh,
					"Option -%c requires an argument.",
					state->optopt);
			} else if (isprint(state->optopt)) {
				shell_print(sh,
					"Unknown option `-%c'.",
					state->optopt);
			} else {
				shell_print(sh,
					"Unknown option character `\\x%x'.",
					state->optopt);
			}
			return 1;
		default:
			break;
		}
	}

	shell_print(sh, "aflag = %d, bflag = %d", aflag, bflag);
	return 0;
}

static int cmd_demo_getopt(const struct shell *sh, size_t argc,
			      char **argv)
{
	char *cvalue = NULL;
	int aflag = 0;
	int bflag = 0;
	int c;

	while ((c = getopt(argc, argv, "abhc:")) != -1) {
		switch (c) {
		case 'a':
			aflag = 1;
			break;
		case 'b':
			bflag = 1;
			break;
		case 'c':
			cvalue = optarg;
			break;
		case 'h':
			/* When getopt is active shell is not parsing
			 * command handler to print help message. It must
			 * be done explicitly.
			 */
			shell_help(sh);
			return SHELL_CMD_HELP_PRINTED;
		case '?':
			if (optopt == 'c') {
				shell_print(sh,
					"Option -%c requires an argument.",
					optopt);
			} else if (isprint(optopt)) {
				shell_print(sh, "Unknown option `-%c'.",
					optopt);
			} else {
				shell_print(sh,
					"Unknown option character `\\x%x'.",
					optopt);
			}
			return 1;
		default:
			break;
		}
	}

	shell_print(sh, "aflag = %d, bflag = %d", aflag, bflag);
	return 0;
}

static int cmd_demo_params(const struct shell *shell, size_t argc, char **argv)
{
	shell_print(shell, "argc = %zd", argc);
	for (size_t cnt = 0; cnt < argc; cnt++) {
		shell_print(shell, "  argv[%zd] = %s", cnt, argv[cnt]);
	}

	return 0;
}

static int cmd_demo_hexdump(const struct shell *shell, size_t argc, char **argv)
{
	shell_print(shell, "argc = %zd", argc);
	for (size_t cnt = 0; cnt < argc; cnt++) {
		shell_print(shell, "argv[%zd]", cnt);
		shell_hexdump(shell, argv[cnt], strlen(argv[cnt]));
	}

	return 0;
}
#endif

static int cmd_version(const struct shell *shell, size_t argc, char **argv)
{
	ARG_UNUSED(argc);
	ARG_UNUSED(argv);

	shell_print(shell, "Zephyr version %s", KERNEL_VERSION_STRING);

	return 0;
}

SHELL_CMD_ARG_REGISTER(version, NULL, "Show kernel version", cmd_version, 1, 0);

void main(void)
{
	printk("\nWelcome to smrk100g");

	setup_dev(DEV_SET);
	vdd_3r3_on(1);

#if DT_NODE_HAS_COMPAT(DT_CHOSEN(zephyr_shell_uart), zephyr_cdc_acm_uart)
	const struct device *dev;
	uint32_t dtr = 0;

	dev = DEVICE_DT_GET(DT_CHOSEN(zephyr_shell_uart));
	if (!device_is_ready(dev) || usb_enable(NULL)) {
		return;
	}

	while (!dtr) {
		uart_line_ctrl_get(dev, UART_LINE_CTRL_DTR, &dtr);
		k_sleep(K_MSEC(100));
	}
#endif
}
```

## src/boardctl.c
```c
#include <stdlib.h>
#include <sys/byteorder.h>
#include <drivers/gpio.h>


#include "lib.h"
#include "gpio.h"

char *i2c_dev = 0;

#define VDD_EN_3R3_NODE	DT_ALIAS(en_vdd_3r3)
static const struct gpio_dt_spec enable_vdd_33 = GPIO_DT_SPEC_GET(VDD_EN_3R3_NODE, gpios);

static int
setup_vdd_3r3()
{
	int rval;
	if (!(rval=device_is_ready(enable_vdd_33.port))) {
		printk("Not ready Enable VDD 3R3 (%d)\n", rval);
		return -ENODEV;
	}
#if 1
/*	if ((rval=gpio_pin_configure_dt(&enable_vdd_33, GPIO_OUTPUT_ACTIVE)) < 0) {*/
	if ((rval=gpio_pin_configure_dt(&enable_vdd_33, GPIO_OUTPUT)) < 0) {
		printk("Enable VDD 3R3 config error: %d\n", rval);
		return -EIO;
	}
#endif
	gpio_dump_regs(XGPIOA);
	return 0;
}

int
vdd_3r3_off()
{
	int rval = setup_vdd_3r3();

	if (rval == 0)
		rval = gpio_pin_set_dt(&enable_vdd_33, 0);
	return rval;
}

int
vdd_3r3_on()
{
	int rval = setup_vdd_3r3();

	if (rval == 0) {
		printk("Enable 3.3\n");
		gpio_dump1(XGPIOA,GPIO_ODR); 
		rval = gpio_pin_set_dt(&enable_vdd_33, 1);
		gpio_dump1(XGPIOA,GPIO_ODR); 
		printk("rval=%d\n", rval);
	}
	return rval;
}

/*
 * if func == DEV_REINIT, reinitialize to default
 */
void
setup_dev(int func)
{
	//printk("func = %d, i2c_dev = %d\n", func, (int) i2c_dev);
	if ((func == DEV_REINIT) && i2c_dev) {
		free(i2c_dev);
		i2c_dev = NULL;
	}
	if (!i2c_dev) {
		i2c_dev = strdup(DEF_BUS);
	}
		
}
```

## src/gpio.h
```c
/*
 * GPIO Defs
 */
#define XGPIOA 0
#define XGPIOB 1
#define XGPIOC 2
#define XGPIO_LAST 2

#define GPIO_MODER	0
#define GPIO_OTYPER	1
#define GPIO_SPEEDR	2
#define GPIO_PUPDR  3
#define GPIO_IDR	4
#define GPIO_ODR	5
#define GPIO_BSRR	6
#define GPIO_LOCKR	7
#define GPIO_AFRL	8
#define GPIO_AFRH	9
#define GPIO_LAST_REG 10

extern void gpio_dump1(int, int);
extern int gpio_set1(int, int, int);
extern int gpio_dump_regs(int);
```

## src/lib.c
```c
#include <stdlib.h>
#include <string.h>
#include <ctype.h>
#include "lib.h"



char *strdup(const char *s)
{
	char *dest = malloc(strlen(s)+1);

	if (dest) {
		strcpy(dest, s);
	}

	return dest;
}

/**
 * C++ version 0.4 char* style "itoa":
 * Written by Lukás Chmela
 * Released under GPLv3.
 */
char* itoa(int value, char* result, int base) {
    // check that the base if valid
    if (base < 2 || base > 36) { *result = '\0'; return result; }

    char *ptr = result, *ptr1 = result, tmp_char;
    int tmp_value;

    do {
        tmp_value = value;
        value /= base;
        *ptr++ = "zyxwvutsrqponmlkjihgfedcba9876543210123456789abcdefghijklmnopqrstuvwxyz" [35 + (tmp_value - value * base)];
    } while ( value );

    // Apply negative sign
    if (tmp_value < 0) *ptr++ = '-';
    *ptr-- = '\0';
    while(ptr1 < ptr) {
        tmp_char = *ptr;
        *ptr--= *ptr1;
        *ptr1++ = tmp_char;
    }
    return result;
}

char* toLower(char* s) {
  for(char *p=s; *p; p++) *p=tolower(*p);
  return s;
}
char* toUpper(char* s) {
  for(char *p=s; *p; p++) *p=toupper(*p);
  return s;
}
```
