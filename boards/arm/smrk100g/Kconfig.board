## boards/arm/smrk100g/Kconfig.board
```kconfig
# SMRK100G board configuration

# Copyright (c) 2017 Fenix Engineering Solutions
# SPDX-License-Identifier: Apache-2.0

config BOARD_SMRK100G
	bool "SMRK100G Development Board"
	depends on SOC_STM32F411XE
```

## boards/arm/smrk100g/Kconfig.defconfig
```kconfig
# SMRK100G board configuration

# Copyright (c) 2017 Fenix Engineering Solutions
# SPDX-License-Identifier: Apache-2.0

if BOARD_SMRK100G

config BOARD
	default "smrk100g"

endif # BOARD_SMRK100G
```
