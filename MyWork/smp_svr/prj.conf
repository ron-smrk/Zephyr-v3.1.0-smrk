## CMakeLists.txt
```
cmake_minimum_required(VERSION 3.20.0)
# Top-level CMakeLists.txt for the skeleton application.
#
# Copyright (c) 2017 Open Source Foundries Limited
#
# SPDX-License-Identifier: Apache-2.0
#
# This provides a basic application structure suitable for communication using
# mcumgr.  It can be used as a starting point for new applications.

# Standard Zephyr application boilerplate.
find_package(Zephyr REQUIRED HINTS $ENV{ZEPHYR_BASE})
project(smp_svr)

target_sources(app PRIVATE src/main.c src/my2c.c src/lib.c src/led.c src/boardctl.c src/gpio.c src/pmbus.c src/irps5401.c src/vrails.c src/pmbus_cmds.c)
target_sources_ifdef(CONFIG_MCUMGR_SMP_BT app PRIVATE src/bluetooth.c)
target_sources_ifdef(CONFIG_MCUMGR_SMP_UDP app PRIVATE src/udp.c)
```

## prj.conf
```kconfig
# Enable mcumgr.
CONFIG_MCUMGR=y

# Some command handlers require a large stack.
CONFIG_SYSTEM_WORKQUEUE_STACK_SIZE=2304
CONFIG_MAIN_STACK_SIZE=2048

# Ensure an MCUboot-compatible binary is generated.
CONFIG_BOOTLOADER_MCUBOOT=y

# Enable flash operations.
CONFIG_FLASH=y

# Required by the `taskstat` command.
CONFIG_THREAD_MONITOR=y

# Support for taskstat command
CONFIG_OS_MGMT_TASKSTAT=y

# Enable statistics and statistic names.
CONFIG_STATS=y
CONFIG_STATS_NAMES=y

# Enable most core commands.
CONFIG_MCUMGR_CMD_IMG_MGMT=y
CONFIG_MCUMGR_CMD_OS_MGMT=y
CONFIG_MCUMGR_CMD_STAT_MGMT=y

# Enable logging
CONFIG_LOG=y
CONFIG_MCUBOOT_UTIL_LOG_LEVEL_WRN=y

# overlay-serial.conf 
# Enable the serial mcumgr transport.
CONFIG_MCUMGR_SMP_UART=y

# # overlay-fs.conf 
# # Enable the LittleFS file system.
# CONFIG_FILE_SYSTEM=y
# CONFIG_FILE_SYSTEM_LITTLEFS=y

# # Add 256 bytes to accommodate upload command (lfs_stat overflows)
# CONFIG_SYSTEM_WORKQUEUE_STACK_SIZE=2304

# # Enable file system commands
# CONFIG_MCUMGR_CMD_FS_MGMT=y

# overlay-shell-mgmt.conf 
# Enable shell commands.
#CONFIG_SHELL=y
#CONFIG_SHELL_BACKEND_SERIAL=n
#CONFIG_MCUMGR_CMD_SHELL_MGMT=y

CONFIG_SERIAL=y
CONFIG_UART_LINE_CTRL=y

# overlay-serial.conf
# Enable the serial mcumgr transport.
CONFIG_MCUMGR_SMP_UART=y

# overlay-shell.conf 
# Enable the shell mcumgr transport.
CONFIG_MCUMGR_SMP_SHELL=y

# mcumgr-cli application doesn't accepts log in the channel it uses
CONFIG_SHELL_LOG_BACKEND=n

# cat overlay-shell-mgmt.conf 
# Enable shell commands.
CONFIG_SHELL=y
CONFIG_SHELL_BACKEND_SERIAL=n
CONFIG_MCUMGR_CMD_SHELL_MGMT=y

CONFIG_REBOOT=y

CONFIG_GPIO=y
CONFIG_I2C=y
 
CONFIG_I2C_SHELL=y
 
#CONFIG_SENSOR_SHELL=y
#CONFIG_SENSOR=y

CONFIG_RAM_CONSOLE=y
#CONFIG_MINIMAL_LIBC_MALLOC_ARENA_SIZE=1024
CONFIG_NEWLIB_LIBC=y
```

## src/main.c
```c
/*
 * Copyright (c) 2012-2014 Wind River Systems, Inc.
 * Copyright (c) 2020 Prevas A/S
 *
 * SPDX-License-Identifier: Apache-2.0
 */

#include <zephyr/zephyr.h>
#include <zephyr/stats/stats.h>
#include <zephyr/shell/shell.h>
#include <version.h>
#include <stdlib.h>
#include <zephyr/drivers/uart.h>
#include <zephyr/usb/usb_device.h>
#include <ctype.h>
#include "lib.h"
#include "pmbus.h"
#include "vrails.h"

#ifdef CONFIG_MCUMGR_CMD_FS_MGMT
#include <zephyr/device.h>
#include <zephyr/fs/fs.h>
#include "fs_mgmt/fs_mgmt.h"
#include <zephyr/fs/littlefs.h>
#endif
#ifdef CONFIG_MCUMGR_CMD_OS_MGMT
#include "os_mgmt/os_mgmt.h"
#endif
#ifdef CONFIG_MCUMGR_CMD_IMG_MGMT
#include "img_mgmt/img_mgmt.h"
#endif
#ifdef CONFIG_MCUMGR_CMD_STAT_MGMT
#include "stat_mgmt/stat_mgmt.h"
#endif
#ifdef CONFIG_MCUMGR_CMD_SHELL_MGMT
#include "shell_mgmt/shell_mgmt.h"
#endif
#ifdef CONFIG_MCUMGR_CMD_FS_MGMT
#include "fs_mgmt/fs_mgmt.h"
#endif

#define LOG_LEVEL LOG_LEVEL_DBG
#include <zephyr/logging/log.h>
LOG_MODULE_REGISTER(smp_sample);

#include "common.h"

/* Define an example stats group; approximates seconds since boot. */
STATS_SECT_START(smp_svr_stats)
STATS_SECT_ENTRY(ticks)
STATS_SECT_END;

/* Assign a name to the `ticks` stat. */
STATS_NAME_START(smp_svr_stats)
STATS_NAME(smp_svr_stats, ticks)
STATS_NAME_END(smp_svr_stats);

/* Define an instance of the stats group. */
STATS_SECT_DECL(smp_svr_stats) smp_svr_stats;

#ifdef CONFIG_MCUMGR_CMD_FS_MGMT
FS_LITTLEFS_DECLARE_DEFAULT_CONFIG(cstorage);
static struct fs_mount_t littlefs_mnt = {
	.type = FS_LITTLEFS,
	.fs_data = &cstorage,
	.storage_dev = (void *)FLASH_AREA_ID(storage),
	.mnt_point = "/lfs1"
};
#endif

static int cmd_version(const struct shell *shell, size_t argc, char **argv)
{
	ARG_UNUSED(argc);
	ARG_UNUSED(argv);

	shell_print(shell, "Version %s", KERNEL_VERSION_STRING);

	return 0;
}

SHELL_CMD_ARG_REGISTER(version, NULL, "Show kernel version", cmd_version, 1, 0);

void status_poll(void *id, void *unused1, void *unused2)
{
	ARG_UNUSED(unused1);
	ARG_UNUSED(unused2);

	int my_id = POINTER_TO_INT(id);

	while (1) {
		//printk("Thread %d running\n", my_id);
		k_msleep(1000);
	}
}

#define STACK_SIZE (768 + CONFIG_TEST_EXTRA_STACK_SIZE)
static K_THREAD_STACK_DEFINE(pmstack, STACK_SIZE);
static struct k_thread pmpoll;	// Power Management
#define PRIORITY 0
static k_tid_t poll_tid;

void main(void)
{
	printk("\nWelcome to smrk100g (%s)", KERNEL_VERSION_STRING);

	setup_dev(DEV_SET);

	start_cpu(); // Bring up CPU

	poll_tid = k_thread_create(&pmpoll, &pmstack, STACK_SIZE, status_poll,
					NULL, NULL, NULL, 0, 0, K_MSEC(1000));
	/*              p1 p1 p3 PR op delay */

	k_thread_name_set(poll_tid, "Board Status");

	int rc = STATS_INIT_AND_REG(smp_svr_stats, STATS_SIZE_32,
				    "smp_svr_stats");

	if (rc < 0) {
		LOG_ERR("Error initializing stats system [%d]", rc);
	}

	/* Register the built-in mcumgr command handlers. */
#ifdef CONFIG_MCUMGR_CMD_FS_MGMT
	rc = fs_mount(&littlefs_mnt);
	if (rc < 0) {
		LOG_ERR("Error mounting littlefs [%d]", rc);
	}

	fs_mgmt_register_group();
#endif
#ifdef CONFIG_MCUMGR_CMD_OS_MGMT
	os_mgmt_register_group();
#endif
#ifdef CONFIG_MCUMGR_CMD_IMG_MGMT
	img_mgmt_register_group();
#endif
#ifdef CONFIG_MCUMGR_CMD_STAT_MGMT
	stat_mgmt_register_group();
#endif
#ifdef CONFIG_MCUMGR_CMD_SHELL_MGMT
	shell_mgmt_register_group();
#endif
#ifdef CONFIG_MCUMGR_SMP_BT
	start_smp_bluetooth();
#endif
#ifdef CONFIG_MCUMGR_SMP_UDP
	start_smp_udp();
#endif

	if (IS_ENABLED(CONFIG_USB_DEVICE_STACK)) {
		rc = usb_enable(NULL);
		if (rc) {
			LOG_ERR("Failed to enable USB");
			return;
		}
	}
	/* using __TIME__ ensure that a new binary will be built on every
	 * compile which is convenient when testing firmware upgrade.
	 */
	LOG_INF("build time (DEADBEEF!): " __DATE__ " " __TIME__);

	/* The system work queue handles all incoming mcumgr requests.  Let the
	 * main thread idle while the mcumgr server runs.
	 */
	while (1) {
		k_sleep(K_MSEC(1000));
		STATS_INC(smp_svr_stats, ticks);
//		printk("BEEP!\n");
	}
}


struct pin {
	char *name;		/* name */
	int cval;		/* current value */
	int	func;		/* SET_POR, etc */
};
struct pin pintab[] = {
	{"srst", 0, SET_SRST},
	{"por", 0, SET_POR},
	{"prog", 0, SET_PROG},
	{"all", 0, SET_ALL},
	{NULL, 0, 0}
};
		
int
set_cmd(const struct shell *shell, size_t argc, char *argv[])
{
	int i;
	if (argc == 1) {
		printk("\n");
		for (i = 0; pintab[i].func != SET_ALL; i++)
			printk("%s: %d\n", pintab[i].name, pintab[i].cval);
		return 0;
	}
	
	if (argc != 3) {
		printk("usage set <LINE> <VALUE>\n");
		return -1;
	}
	char *line = toLower(argv[1]);
	int val = atoi(argv[2]);

	if ((val < 0) || (val > 1)) {
		printk("val must be 1 or 0\n");
		return -1;
	}

	int match = 0;
	for (i = 0; pintab[i].name; i++) {
		if (strcmp(line, pintab[i].name) == 0) {
			set_ps_bit(pintab[i].func, val);
			if (pintab[i].func == SET_ALL) {
				int i2;
				for (i2 = 0; pintab[i2].func != SET_ALL; i2++) {
					pintab[i2].cval = val;
				}
			} else {
				pintab[i].cval = val;
			}
			match++;
		}
	}
	if (match)
		return 0;

	printk("line must one of: ");
	for (i = 0; pintab[i].name; i++) {
		printk("%s ", pintab[i].name);
	}
	printk("\n");
	return -1;
}
SHELL_CMD_ARG_REGISTER(set, NULL, "set <LINE> <VAL>", set_cmd, 0, 0);

struct pin status[] = {
	{"done_b", 0, GET_DONE_B},
	{"init", 0, GET_INIT},
	{NULL, 0, 0}
};

int
get_cmd(const struct shell *shell, size_t argc, char *argv[])
{
	int i;

	if (argc == 1) {
		printk("\n");
		for (i = 0; status[i].name; i++)
			printk("%s: %d\n", status[i].name, get_ps_stat(status[i].func));
		return 0;
	}
	if (argc != 2) {
		printk("usage get <LINE>\n");
		return -1;
	}

	char *line = toLower(argv[1]);
	int match = 0;
	for (i = 0; status[i].name; i++) {
		if (strcmp(line, status[i].name) == 0) {
			printk("\n%s: %d\n", status[i].name, get_ps_stat(status[i].func));
			match++;
		}
	}
	if (match)
		return 0;
	printk("line must be one of: " );
	for (i = 0; status[i].name; i++) {
		printk("%s ", status[i].name);
	}
	printk("\n");
	return -1;
}



SHELL_CMD_ARG_REGISTER(get, NULL, "get <LINE>", get_cmd, 0, 0);
	
```

## src/boardctl.c
```c
#include <stdlib.h>
#include <sys/byteorder.h>
#include <drivers/gpio.h>


#include "lib.h"
#include "gpio.h"
#include "pmbus.h"

#include "vrails.h"

char *i2c_dev = 0;
static int gpios_inited = 0;

#define EN_0R85_NODE DT_ALIAS(en_0r85)
static const struct gpio_dt_spec en_0r85 = GPIO_DT_SPEC_GET_OR(EN_0R85_NODE, gpios, {0});
#define PG_0R85_NODE DT_ALIAS(pg_0r85)
static const struct gpio_dt_spec pg_0r85 = GPIO_DT_SPEC_GET_OR(PG_0R85_NODE, gpios, {0});

#define PG_1R8_NODE DT_ALIAS(pg_1r8)
static const struct gpio_dt_spec pg_1r8 = GPIO_DT_SPEC_GET_OR(PG_1R8_NODE, gpios, {0});

#define EN_3R3_NODE	DT_ALIAS(en_3r3)
static const struct gpio_dt_spec en_3r3 = GPIO_DT_SPEC_GET(EN_3R3_NODE, gpios);
// Need PG_VDD_3R3

#define EN_1R2_DDR_NODE DT_ALIAS(en_1r2_ddr)
static const struct gpio_dt_spec en_1r2_ddr = GPIO_DT_SPEC_GET_OR(EN_1R2_DDR_NODE, gpios, {0});
#define PG_1R2_DDR_NODE DT_ALIAS(pg_1r2_ddr)
static const struct gpio_dt_spec pg_1r2_ddr = GPIO_DT_SPEC_GET_OR(PG_1R2_DDR_NODE, gpios, {0});

#define EN_0R6_NODE DT_ALIAS(en_0r6)
static const struct gpio_dt_spec en_0r6 = GPIO_DT_SPEC_GET_OR(EN_0R6_NODE, gpios, {0});
#define PG_0R6_NODE DT_ALIAS(pg_0r6)
static const struct gpio_dt_spec pg_0r6 = GPIO_DT_SPEC_GET_OR(PG_0R6_NODE, gpios, {0});


#define PG_2R5_NODE DT_ALIAS(pg_2r5)
static const struct gpio_dt_spec pg_2r5 = GPIO_DT_SPEC_GET_OR(PG_2R5_NODE, gpios, {0});

#define EN_1R2_MGT_NODE DT_ALIAS(en_1r2_mgt)
static const struct gpio_dt_spec en_1r2_mgt = GPIO_DT_SPEC_GET_OR(EN_1R2_MGT_NODE, gpios, {0});
#define PG_1R2_MGT_NODE DT_ALIAS(pg_1r2_mgt)
static const struct gpio_dt_spec pg_1r2_mgt = GPIO_DT_SPEC_GET_OR(PG_1R2_MGT_NODE, gpios, {0});

#define PG_0R9_NODE DT_ALIAS(pg_0r9)
static const struct gpio_dt_spec pg_0r9 = GPIO_DT_SPEC_GET_OR(PG_0R9_NODE, gpios, {0});

#define PG_1R0_NODE DT_ALIAS(pg_1r0)
static const struct gpio_dt_spec pg_1r0 = GPIO_DT_SPEC_GET_OR(PG_1R0_NODE, gpios, {0});

#define ZYNQ_PS_POR_NODE DT_ALIAS(zynq_ps_por)
static const struct gpio_dt_spec zynq_por = GPIO_DT_SPEC_GET(ZYNQ_PS_POR_NODE, gpios);

#define ZYNQ_PS_SRST_NODE DT_ALIAS(zynq_ps_srst)
static const struct gpio_dt_spec zynq_srst = GPIO_DT_SPEC_GET(ZYNQ_PS_SRST_NODE, gpios);

#define ZYNQ_PS_PROG_NODE DT_ALIAS(zynq_ps_prog)
static const struct gpio_dt_spec zynq_prog = GPIO_DT_SPEC_GET(ZYNQ_PS_PROG_NODE, gpios);


#define QSFP_RESETL_NODE DT_ALIAS(qsfp_resetl)
// Remove when used
__attribute__ ((unused))
static const struct gpio_dt_spec qsfp_reset = GPIO_DT_SPEC_GET(QSFP_RESETL_NODE, gpios);

#define QSFP_LPMODE_NODE DT_ALIAS(qsfp_lpmode)
// Remove when used
__attribute__ ((unused))
static const struct gpio_dt_spec qsfp_lowpower_mode = GPIO_DT_SPEC_GET(QSFP_LPMODE_NODE, gpios);

#define ZYNQ_PS_INIT_NODE DT_ALIAS(zynq_ps_init)
static const struct gpio_dt_spec zynq_init = GPIO_DT_SPEC_GET(ZYNQ_PS_INIT_NODE, gpios);

#define ZYNQ_PS_DONE_B_NODE DT_ALIAS(zynq_ps_done_b)
static const struct gpio_dt_spec zynq_done_b = GPIO_DT_SPEC_GET(ZYNQ_PS_DONE_B_NODE, gpios);
/*
 * if func == DEV_REINIT, reinitialize to default
 */
void
setup_dev(int func)
{
	//printk("func = %d, i2c_dev = %d\n", func, (int) i2c_dev);
	if ((func == DEV_REINIT) && i2c_dev) {
		free(i2c_dev);
		i2c_dev = NULL;
	}
	if (!i2c_dev) {
		i2c_dev = strdup(DEF_BUS);
	}

	if (!gpios_inited) {
		gpios_inited = 1;
		//gpio_dump_regs(XGPIOA);

		gpio_pin_configure_dt(&en_0r85, GPIO_OUTPUT);
		gpio_pin_configure_dt(&pg_0r85, GPIO_INPUT);
		vrail[VDD_0R85].enable_node = &en_0r85;
		vrail[VDD_0R85].isgood_node = &pg_0r85;

		gpio_pin_configure_dt(&pg_1r8, GPIO_INPUT);
		vrail[VDD_1R8].isgood_node = &pg_1r8;

		gpio_pin_configure_dt(&en_3r3, GPIO_OUTPUT);
		vrail[VDD_3R3].enable_node = &en_3r3;
		
		// Need pg_3r3....

		gpio_pin_configure_dt(&en_1r2_ddr, GPIO_OUTPUT);
		gpio_pin_configure_dt(&pg_1r2_ddr, GPIO_INPUT);
		vrail[VDD_1R2_DDR].enable_node = &en_1r2_ddr;
		vrail[VDD_1R2_DDR].isgood_node = &pg_1r2_ddr;

		gpio_pin_configure_dt(&en_0r6, GPIO_OUTPUT);
		gpio_pin_configure_dt(&pg_0r6, GPIO_INPUT);
		vrail[VDD_0R6].enable_node = &en_0r6;
		vrail[VDD_0R6].isgood_node = &pg_0r6;

		gpio_pin_configure_dt(&pg_2r5, GPIO_INPUT);
		vrail[VDD_2R5].enable_node = &pg_2r5;
		
		gpio_pin_configure_dt(&en_1r2_mgt, GPIO_OUTPUT);	
		gpio_pin_configure_dt(&pg_1r2_mgt, GPIO_INPUT);

		gpio_pin_configure_dt(&pg_0r9, GPIO_INPUT);
		vrail[VDD_0R9].isgood_node = &pg_0r9;

		gpio_pin_configure_dt(&pg_1r0, GPIO_INPUT);
		vrail[VDD_1R0].isgood_node = &pg_1r0;

		gpio_pin_configure_dt(&zynq_srst, GPIO_OUTPUT);
		gpio_pin_configure_dt(&zynq_por, GPIO_OUTPUT);
		gpio_pin_configure_dt(&zynq_prog, GPIO_OUTPUT);
		gpio_pin_configure_dt(&qsfp_lowpower_mode, GPIO_OUTPUT);

		gpio_pin_configure_dt(&zynq_init, GPIO_INPUT);
		gpio_pin_configure_dt(&zynq_done_b, GPIO_INPUT);

//gpio_dump_regs(XGPIOA);
		//gpio_dump_regs(XGPIOB);
		//gpio_dump_regs(XGPIOC);

	}
}

/*
 * Sundar email - 1/10/23
 * deassert zynq_ps_prog (set PC1 to '0'')
 * deassert zynq_ps_srst (set PC3 to '0')
 * assert zynq_ps_por (set PC4 to '1')
 * After power is up.
 * deassert zynq_ps_por (set PC3 to '0')
 */
void
start_cpu()
{
	gpio_pin_set_dt(&zynq_prog, 0);
	gpio_pin_set_dt(&zynq_srst, 0);
	gpio_pin_set_dt(&zynq_por, 1);
	//printk("setting prog=0, stst=0, por=1\n");

	set_vrails(POWER_ON, 0, 0);

	int delay = 11;
	printk("Delay %d mSec\n", delay);
	k_sleep(K_MSEC(delay));

	gpio_pin_set_dt(&zynq_por, 0);
	//printk("setting por=0\n");

}

void
set_ps_bit(int line, int val)
{
	switch(line) {
	case SET_POR:
		gpio_pin_set_dt(&zynq_por, val);
		break;
	case SET_SRST:
		gpio_pin_set_dt(&zynq_srst, val);
		break;
	case SET_PROG:
		gpio_pin_set_dt(&zynq_prog, val);
		break;
	case SET_ALL:
		gpio_pin_set_dt(&zynq_srst, val);
		gpio_pin_set_dt(&zynq_por, val);
		gpio_pin_set_dt(&zynq_prog, val);
		break;
	default:
		printk("bad line...\n");
	}
}

int get_ps_stat(int line)
{
	switch(line) {
	case GET_DONE_B:
		return gpio_pin_get_dt(&zynq_done_b);
	case GET_INIT:
		return gpio_pin_get_dt(&zynq_init);
	}
	printk("OOPS!!!\n");
	return 0xdeadbeef;
}
```

## src/irps5401.c
```c
#include <stdlib.h>
#include <sys/byteorder.h>


#include <zephyr/device.h>
#include <zephyr/drivers/i2c.h>
#include <drivers/gpio.h>
#include <zephyr/zephyr.h>
#include <zephyr/shell/shell.h>
#include "lib.h"
#include "pmbus.h"
#include "irps5401.h"
#include "pmbus_cmds.h"
#include "vrails.h"
#include "my2c.h"
#include <errno.h>
#include <string.h>
#include <math.h>

struct pm_list {
	unsigned char getcmd;
//	unsigned char setcmd;
	int size;
	char *name;
	char *units;
	int type;
} pm_info [] = {
	{PMBUS_READ_VOUT, 2, "Output Voltage", "Volts", PM_LINEAR8},
	{PMBUS_READ_IOUT, 2, "Output Current", "Amps", PM_LINEAR11},
	{PMBUS_READ_TEMPERATURE_1, 2, "Temperature", "Degrees C", PM_LINEAR11},
	{PMBUS_TON_RISE, 2, "Output Voltage Rise Time", "mSec", PM_LINEAR2},
	{PMBUS_POWER_GOOD_ON, 2, "Power Good On", "Volts", PM_LINEAR8},
	{PMBUS_POWER_GOOD_OFF, 2, "Power Good Off", "Volts", PM_LINEAR8},
	{}
};

struct mapping {
	char *name;
	int val;
};

int
irps_setpage(int bus, unsigned char page)
{
	unsigned char read_page;

	// printk("setting to page %d, bus=%d\n", page, bus);
	pmbus_write(bus, PMBUS_PAGE, 1, &page);

	pmbus_read(bus, PMBUS_PAGE, 1, &read_page);

	if (page != read_page) {
		printk("bus: %d, Failed to set page to %d (read back %d instead)\n",
			   bus, page, read_page);
		return -EIO;
	}
	return read_page;
}

int
irps_reg(int rail, struct pmbus_op *p)
{
	int bus = get_bus(rail);
	char	data[8];
	int		val;
	double	fval;
	unsigned short v;

	if (bus < 0) {
		// printk("pmbus_get_vout: Ret err\n");
		return -1;
	}

	int type = vrail[rail].type;
	if (type & ISIRPS_CHIP) {
		irps_setpage(bus, (unsigned char)type&LOOP_MASK);
	}

	if (p->mode == PMWRITE) {
		if (p->rawmode) {
			val = strtol(p->value, NULL, 16);
			// printk("data (raw) - 0x%x\n", val);
		} else {
			// printk("data str: --%s--\n", p->value);
			fval = atof(p->value);
			// printk("data (float) - %s\n", f2str(fval, 2));
			val = encode(fval, p->encoding);
			// printk("data (raw) - 0x%x\n", val);
		}
		data[1] = (val >> 8) & 0xff;
		data[0] = val & 0xff;
		//data[1] = 0xf0;
		// printk("irps setting rail: %d, reg: 0x%x, value: 0x%x 0x%x\n", rail, p->reg, data[0], data[1]);
		pmbus_write(bus, p->reg, p->size, data);
	} else {
		// printk("irps getting rail: %d, reg: 0x%x\n", rail, p->reg);
		pmbus_read(bus, p->reg, p->size, data);
		// printk("got data: 0x%x 0x%x\n", data[0], data[1]);
		v = toshort(data);
		fval = decode(v, p->encoding);
		printk("Reg: 0x%x, Value: %s\n", p->reg, f2str(fval, 4));
	}
	return 0;
}


/*
 * Mode setting, ON or OFF
 */
int
irps_setop(int bus, int rail, int mode)
{
	unsigned char byte;
	if (mode == VOLT_ON) {
		byte = 0x80;
	} else if (mode == VOLT_OFF) {
		byte = 0;
	} else {
		printk("Bad mode\n");
		return -EINVAL;
	}
	if (irps_setpage(bus, rail) < 0) {
		printk("Can't set page %d\n", rail);
		return -EIO;
	}
	return pmbus_write(bus, PMBUS_OPERATION, 1, &byte);
}


/*
 * Assume page is set already
 */
static int
dumpval(int bus, struct pm_list *p, int rail)
{
	unsigned char id[8];
	unsigned short v;
	//printk("Read cmd: 0x%x, sz: 0x%x\n", p->getcmd, p->size);
	pmbus_read(bus, p->getcmd, p->size, id);
	//printk("read 0x%02x 0x%02x\n", id[0], id[1]);
		  
	v = toshort(id);
	if ((p->getcmd == PMBUS_READ_VOUT) && (rail == VDD_1R0)) {
		v /= 2;
	}

	//printk("Got 0x%x for value for %s type=%d units=%s\n", v, p->name, p->type, p->units);
	switch (p->type) {
	case PM_LINEAR8:
	case PM_LINEAR11:
	case PM_LINEAR2:
	case PM_IOUT:
		printk("  %s: %s %s\n", p->name, f2str(decode(v, p->type), 4), p->units);
		break;
	default:
		if (p->size == 1)
			printk("  %s = 0x%02x\n", p->name, v & 0xff);
		else
			printk("  %s = 0x%04x\n", p->name, v);
		break;
	}

	return 0;
}

static int allrails[] = { VDD_0R85, VDD_2R5, VDD_0R9, VDD_1R8, VDD_1R0, -1 };


static int
dumpone(int rail)
{
	struct pm_list *p;
	int bus = IRPS_BUS;
	int type;

	type = vrail[rail].type;
	if (irps_setpage(bus, (unsigned char)type&LOOP_MASK) < 0) {
		printk("Can't set page %d\n", rail);
		return -EIO;
	}
	printk("Rail: %s\n", vrail[rail].signame);
	for (p = pm_info; p->name; p++) {
		if ((rail == VDD_1R0) && (p->getcmd == PMBUS_TON_RISE)) {
		printk("  ----Rise time not supported on LD0---\n");
		} else {
			dumpval(bus, p, rail);
		}
	}
	return 0;
}

static int
dumpall(int rail)
{
	int i;

	if (rail != NUM_RAILS) {
		return dumpone(rail);
	}

	for (i = 0; allrails[i] != -1; i++) {
		dumpone(allrails[i]);
	}
	return 0;
}

int map(char *s, struct mapping *p)
{
	s = toLower(s);
	for (; p->name != NULL; p++) {
		if (strcmp(s, p->name) == 0) {
			return p->val;
		}
	}

	return -1;
}

struct mapping pstates[] = {
	{"0", VOLT_OFF},
	{"off", VOLT_OFF},
	{"1", VOLT_ON},
	{"on", VOLT_ON},
	{NULL,0}
};

static int getpstate(char *s)
{
	return map(s, pstates);
}

struct mapping looptab[] = {
	{"0", VDD_0R85},
	{"1", VDD_2R5},
	{"2", VDD_0R9},
	{"3", VDD_1R8},
	{"4", VDD_1R0},
	{"a", VDD_0R85},
	{"b", VDD_2R5},
	{"c", VDD_0R9},
	{"d", VDD_1R8},
	{"ldo", VDD_1R0},
	{"all", NUM_RAILS},
	{NULL,0}
};

static int
getrail(char *s)
{
	return map(s, looptab);
}

static int
irps_help(const struct shell *sh, size_t argc, char **argv)
{
	ARG_UNUSED(argc);
	ARG_UNUSED(argv);

	printk("\nirps usage:\n");

	printk("irps <dev> [on|off] - Turn device on/off\n");
	printk("irps <dev> dump - dump data associated with rail/loop\n");
	printk("dev may be:\n");
	printk("all - apply to all devices\n");
	printk("[0-4] - devices 0-4, Loops A-D, Loop LDO\n");
	printk("A|B|C|D|LDO (case insensitive)\n");
	return 0;
}

static int
irps_dump(const struct shell *sh, size_t argc, char **argv)
{
	char *dev = toLower(argv[1]);
	int rail;
	
	//printk("\nDumping Device %s\n", dev);

	rail = getrail(dev);
	//printk("rail = %d\n", rail);
	if (rail < 0) {
		printk("Bad rail %s\n", dev);
		return -1;
	}

	dumpall(rail);
#if 0
	double v;
	v = pmread_vout(0x40, rail);
	printk("V: %.4f\n", v);
#endif
	return 0;
}
static int
irps_main(const struct shell *sh, size_t argc, char **argv)
{
	int rail;
	int val;

	char *dev = toLower(argv[1]);
	char *state = toLower(argv[2]);

	rail = getrail(dev);
	printk("irps_main, rail=%d\n", rail);
	if (rail < 0) {
		printk("Command error: Bad rail %s\n", dev);
		return -1;
	}

	val = getpstate(state);
	
	if (val < 0) {
		printk("Command error: Bad power state %s\n", state);
		return -1;
	}
	printk("\nturning rail %s (%d) %s\n", dev, rail, state);
	irps_setop(IRPS_BUS, vrail[rail].type & LOOP_MASK, val);

	return 0;
}

			  
/******************************************************************
 * IRPS commands
 * irps help
 * irps <dev> [on|offp]
 * irps dump <dev>
 *
 * dev: 0-4, a-d, ldo, all
 */
SHELL_SUBCMD_SET_CREATE(sub_irps, (irps));
SHELL_SUBCMD_ADD((irps), help, NULL, "help for irps", irps_help, 1, 0);
SHELL_SUBCMD_ADD((irps), dump, NULL, "Dump Info", irps_dump, 2, 0);
//SHELL_CMD_REGISTER(irps, &sub_irps, "IRPS 5401 Commands", NULL);
SHELL_CMD_ARG_REGISTER(irps, &sub_irps, "IRPS 5401 Commands", irps_main, 1, 3);
```

## src/irps5401.h
```c
#ifndef __IRPS5401_H
#define __IRPS5401_H

#include <zephyr/sys/util_macro.h>


enum irps5401_registers {
	PMBUS_MFR_REG_ACCESS			= 0xD0, /* Block Write, R word */
	PMBUS_MFR_I2C_ADDRESS			= 0xD6, /* R/W byte */
	PMBUS_MFR_TPGDLY				= 0xD8, /* R/W word */
	PMBUS_MFR_FCCM					= 0xD9, /* R/W word */
	PMBUS_MFR_VOUT_PEAK				= 0xDB, /* R/W word */
	PMBUS_MFR_IOUT_PEAK				= 0xDC, /* R/W word */
	PMBUS_MFR_TEMPERATURE_PEAK		= 0xDD, /* R/W word */
	PMBUS_MFR_LDO_MARGIN			= 0xDE, /* R/W word */
};

#define LOOPA	0
#define LOOPB	1
#define LOOPC	2
#define LOOPD	3
#define LOOPLDO 4

extern int irps_setpage(int, unsigned char);
extern int irps_setop(int, int, int);
extern int irps_setreg(int, int, char *);

#endif /* __IRPS5401_H */
```

## src/lib.c
```c
#include <stdio.h>
#include <stdlib.h>
#include <string.h>
#include <ctype.h>
#include "lib.h"


#include <errno.h>

char *strdup(const char *s)
{
	char *dest = malloc(strlen(s)+1);

	if (dest) {
		strcpy(dest, s);
	}

	return dest;
}

/**
 * C++ version 0.4 char* style "itoa":
 * Written by Lukás Chmela
 * Released under GPLv3.
 */
char* itoa(int value, char* result, int base) {
    // check that the base if valid
    if (base < 2 || base > 36) { *result = '\0'; return result; }

    char *ptr = result, *ptr1 = result, tmp_char;
    int tmp_value;

    do {
        tmp_value = value;
        value /= base;
        *ptr++ = "zyxwvutsrqponmlkjihgfedcba9876543210123456789abcdefghijklmnopqrstuvwxyz" [35 + (tmp_value - value * base)];
    } while ( value );

    // Apply negative sign
    if (tmp_value < 0) *ptr++ = '-';
    *ptr-- = '\0';
    while(ptr1 < ptr) {
        tmp_char = *ptr;
        *ptr--= *ptr1;
        *ptr1++ = tmp_char;
    }
    return result;
}

char* toLower(char* s) {
  for(char *p=s; *p; p++) *p=tolower(*p);
  return s;
}
char* toUpper(char* s) {
  for(char *p=s; *p; p++) *p=toupper(*p);
  return s;
}

/*
 * return char representation of a double, as printk doesn't support %f
 */
#define NSTR 10
#define SLEN 20
static char __tmpbuf[NSTR*SLEN];
static int fptr = 0;
char *
f2str(double v, int ndec)
{
	char *ptr = &__tmpbuf[SLEN*fptr];

	sprintf(ptr, "%.*f", ndec, v);
	fptr += 1;
	if (fptr >= NSTR)
		fptr = 0;
	return ptr;
}

int
ishex(char *s)
{
	int i, len;
	len = strlen(s);
	if (len > MAX_ARGSZ_INT)
		return -EINVAL;
	for ( i = 0; i < len; i++ )
		if (!isxdigit((int)s[i]))
			return 0;
	return 1;
}

double
mytrunc(double f, int roundto)
{

	int x = (int)f;

	x = x+roundto;
	x = (x/roundto)*roundto;
	return (double) x;
}
unsigned short
toshort(unsigned char *x)
{
	return (unsigned short) ((x[0] << 8) | x[1]);
}

unsigned int
toint(unsigned char *x, int nbytes)
{
	unsigned int rval = 0;
	int i = 0;

	for (i = 0; i < nbytes; i++) {
		rval <<= 8;
		//printk("B: rval=0x%x, x[%d]=0x%x\n", rval, i, x[i]);
		rval |= x[i];
		//printk("A: rval=0x%x\n", rval);
	}			
	//printk("return 0x%x (sz=%d)\n", rval, nbytes);
	return rval;
}
```

## src/lib.h
```c
#include <stdlib.h>

#ifndef __MYLIB_H
#define __MYLIB_H

#define DEV_REINIT	0
#define DEV_SET	1
#define DEF_BUS		"I2C_1"
#define MAX_ARGSZ_INT	8

extern char *i2c_dev;
extern int rail;	/* voltage rail on irps5401 (0-4) */



extern int ishex(char *);
extern char *strdup(const char *);
extern char *itoa(int, char *, int);
extern char *toLower(char *);
extern char *toUpper(char *);
extern unsigned int toint(unsigned char *, int);
extern unsigned short toshort(unsigned char *);
extern double mytrunc(double, int);

extern void setup_dev(int);
extern void setup_pos(void);
extern int set_mux(int);
extern int i2c_write_bytes(int, int, char *, int);
extern int i2c_read_bytes(int, int, char *, int);

#endif /* __MYLIB_H */

#define TRUE	(1==1)
#define FALSE	(1==0)

#define VOLT_ON		1
#define  VOLT_OFF	0

#define SET_ALL		-1
#define SET_POR		0
#define SET_SRST	1
#define SET_PROG	2

#define GET_DONE_B	0
#define GET_INIT	1

extern void set_ps_bit(int, int);
extern int get_ps_stat(int);
extern void start_cpu();
extern void set_psbits_hi();
extern char *f2str(double);
```

## src/my2c.c
```c
/*
 * Copyright (c) 2018 Nordic Semiconductor ASA
 *
 * SPDX-License-Identifier: Apache-2.0
 */

#include <stdlib.h>
#include <zephyr/logging/log.h>
#include <zephyr/drivers/i2c.h>
#include <zephyr/shell/shell.h>
#include <drivers/gpio.h>
#include <sys/byteorder.h>

#include "my2c.h"
#include "lib.h"
#include "gpio.h"
static int get_bytes_count_for_hex(int);

LOG_MODULE_REGISTER(app_test);

#define MAX_BYTES_FOR_REGISTER_INDEX	4
#define MAX_I2C_BYTES	16

static int i2c_addresses[] = {
	[QSFP_BUS] = QSFP_ADDR,
	[EEP_BUS] = EEP_ADDR,
	[IRPS_BUS] = IRPS_ADDR,
	[MAX_BUS] = MAX_ADDR,
	[EEPROM_BUS] = EEPROM_ADDR,
	[LED_BUS] = LED_ADDR
};

int get_i2c_addr(int chip)
{
	if (chip > LAST_BUS)
		return -1;
	return i2c_addresses[chip];
}

static int i2c_scan(const struct shell *sh, size_t argc, char **argv)
{
	const struct device *d;
	uint8_t cnt = 0, first = 0x04, last = 0x77;

	/* ARG_UNUSED(argc); */
	/* ARG_UNUSED(argv); */

	d = device_get_binding(i2c_dev);

	if (!d) {
		shell_error(sh, "I2C: Device driver %s not found.",
			    i2c_dev);
		return -ENODEV;
	}
	shell_print(sh, "I2C Bus: %d", get_mux());
	shell_print(sh, "     0  1  2  3  4  5  6  7  8  9  a  b  c  d  e  f");
	for (uint8_t i = 0; i <= last; i += 16) {
		shell_fprintf(sh, SHELL_NORMAL, "%02x: ", i);
		for (uint8_t j = 0; j < 16; j++) {
			if (i + j < first || i + j > last) {
				shell_fprintf(sh, SHELL_NORMAL, "   ");
				continue;
			}

			struct i2c_msg msgs[1];
			uint8_t dst;

			/* Send the address to read from */
			msgs[0].buf = &dst;
			msgs[0].len = 0U;
			msgs[0].flags = I2C_MSG_WRITE | I2C_MSG_STOP;
			if (i2c_transfer(d, &msgs[0], 1, i + j) == 0) {
				shell_fprintf(sh, SHELL_NORMAL,
					      "%02x ", i + j);
				++cnt;
			} else {
				shell_fprintf(sh, SHELL_NORMAL, "-- ");
			}
		}
		shell_print(sh, "");
	}

	shell_print(sh, "%u devices found on %s",
		    cnt, i2c_dev);
	return 0;
}

/* #define LED0_NODE	DT_ALIAS(led0) */
/* static const struct gpio_dt_spec led = GPIO_DT_SPEC_GET(LED0_NODE, gpios); */

#define RST_NODE	DT_ALIAS(rstmux)
static const struct gpio_dt_spec resetmux = GPIO_DT_SPEC_GET(RST_NODE, gpios);
/* 
 * set I2C_BUS_NUMBER
 */
static int i2c_set_bus(const struct shell *sh, size_t argc, char **argv)
{
	int bus;
	ARG_UNUSED(argc);
	ARG_UNUSED(argv);

	//printk("Before setup\n");
	//gpio_dump_regs(XGPIOB);
 	bus = atoi(argv[1]);

	if ( (bus < 0) || (bus > 5)) {
		shell_error(sh, "BUS: %d, error: 0 <= BUSNUM <= 5", bus);
		return -ENODEV;
	}
	//shell_print(sh, "set executed, bus=%d", bus);
	set_mux(bus);
	return 0;
}
/* 
 * DEV I2C_BUS_NAME (I2C_1, etc)
 */
static int i2c_set_dev(const struct shell *sh, size_t argc, char **argv)
{
	ARG_UNUSED(argc);
	ARG_UNUSED(argv);

/*	
	printk("i2c_dev = %d\n", (int) i2c_dev);
	printk("arg[1] = %s\n", argv[1]);
*/
	if (argc == 1) {
		if (!i2c_dev) {
			shell_print(sh, "Current bus unset");
		} else {
			shell_print(sh, "Current bus: %s", i2c_dev);
		}
		return 0;
	}
	
	if (strcmp("-r", argv[1]) == 0) {
		setup_dev(DEV_REINIT);
		shell_print(sh, "I2C bus reset to %s", DEF_BUS);
		return 0;
	}
			

	if (i2c_dev != (char *)NULL) {
		free(i2c_dev);
	}
		
	i2c_dev = malloc(strlen(argv[1])+1);
	strcpy(i2c_dev, argv[1]);
	shell_print(sh,"I2c Bus changed to %s", i2c_dev);

	return 0;
}

int
reset_mux()
{
	int rval;

	if (!device_is_ready(resetmux.port)) {
		printk("Not ready mux\n");
		return -ENODEV;
	}
	rval = gpio_pin_configure_dt(&resetmux, GPIO_OUTPUT_ACTIVE);
	if (rval < 0) {
		printk("MUX config error: %d\n", rval);
		return -EIO;
	}

	// set type to open-drain
	gpio_set1(XGPIOB, GPIO_OTYPER, 0x20);
	// High Speed
	gpio_set1(XGPIOB, GPIO_SPEEDR, 0xc00);
	gpio_pin_set_dt(&resetmux, 0);
	k_msleep(10);
	gpio_pin_set_dt(&resetmux, 1);
	return 0;

}

static int current_mux = -1;
int
set_mux(int busid)
{
	int rval;
	char buf[20];
	
	// only write if different.
	if (current_mux == busid)
		return 0;
	
	if ((rval=reset_mux()) < 0)
		return rval;

	if ( (busid<0) > (busid>7) ) {
		printk("Bad BusID: %d\n", busid);
		return -1;
	}
	// printk("SetMux to %d\n", busid);
	buf[0] = 1<<busid;
	current_mux = busid;
	//printk("reset ok, setting bus to %d.\n", busid);
	i2c_write_bytes(0x74, 0, buf, 1);
	return 0;
	
}

int
get_mux()
{
	return current_mux;
}

int
i2c_read_bytes(int dev_addr, int reg_addr, char *obuf, int olen)
{
	uint8_t reg_addr_buf[MAX_BYTES_FOR_REGISTER_INDEX];
	int reg_addr_bytes;
	const struct device *dev;
	int ret;

	dev = device_get_binding(i2c_dev);
	if (!dev) {
		printk("I2C: Device driver %s not found.", i2c_dev);
		return -ENODEV;
	}
	reg_addr_bytes = get_bytes_count_for_hex(reg_addr);
	sys_put_be32(reg_addr, reg_addr_buf);


	ret = i2c_write_read(dev, dev_addr,
			     reg_addr_buf +
			       MAX_BYTES_FOR_REGISTER_INDEX - reg_addr_bytes,
			     reg_addr_bytes, obuf, olen);
	if (ret < 0) {
		printk("Failed to read from device: 0x%02x", dev_addr);
		return -EIO;
	}
#if 0
	printk("i2c_write_read: 0x%02x  0x%02x  0x%02x  0x%02x\n",
		   obuf[0], obuf[1], obuf[2], obuf[3]);
#endif
	return 0;
}

int
i2c_write_bytes(int dev_addr, int reg_addr, char *ibuf, int ilen)
{
	int ret;
	/* [ 16 + 4 - 1 ] */
	uint8_t buf[MAX_I2C_BYTES + MAX_BYTES_FOR_REGISTER_INDEX - 1];
	const struct device *dev;
	int reg_addr_bytes;

	dev = device_get_binding(i2c_dev);
	if (!dev) {
		printk("I2C: Device driver %s not found.", i2c_dev);
		return -ENODEV;
	}
	reg_addr_bytes = get_bytes_count_for_hex(reg_addr);
	//printk("Write to addr: 0x%x\n", dev_addr);
	//printk("Write to reg:  0x%x\n", reg_addr);

	sys_put_be32(reg_addr, buf);

	
	int i;
	for (i = 0; i < ilen; i++) {
		buf[MAX_BYTES_FOR_REGISTER_INDEX + i] = ibuf[i];
	}

#if 0
	for (i=0; i<8; i++) {
		printk("0x%02x ", buf[i]);
	}
	printk("\n");
#endif
	/* len is 2, 1 for register size, 1 for our data */
	ret = i2c_write(dev,
					buf + MAX_BYTES_FOR_REGISTER_INDEX - reg_addr_bytes,
					ilen+reg_addr_bytes, dev_addr);

	return 0;
}

static
int get_bytes_count_for_hex(int val)
{
	char arg[10];
	itoa(val, arg, 16);

	//printk("%d number is string %s\n", val, arg);
	int length = (strlen(arg) + 1) / 2;

	if (length > 1 && arg[0] == '0' && (arg[1] == 'x' || arg[1] == 'X')) {
		length -= 1;
	}

	return MIN(MAX_BYTES_FOR_REGISTER_INDEX, length);
		
}
SHELL_SUBCMD_SET_CREATE(sub_my2c, (my2c));

SHELL_SUBCMD_ADD((my2c), scan, NULL, "help for scan", i2c_scan, 1, 0);
SHELL_SUBCMD_ADD((my2c), set, NULL, "help for set", i2c_set_bus, 2, 0);
SHELL_SUBCMD_ADD((my2c), dev, NULL, "help for dev", i2c_set_dev, 1, 1);

SHELL_CMD_REGISTER(my2c, &sub_my2c, "I2C Control Functions", NULL);
```

## src/my2c.h
```c
#define QSFP_ADDR	0xFF	// Later...
#define EEP_ADDR	0xff	// also...
#define IRPS_ADDR	0x40
#define MAX_ADDR	0x54
#define EEPROM_ADDR	0x54
#define LED_ADDR	0x43

#define QSFP_BUS	0
#define EEP_BUS		1
#define IRPS_BUS	2
#define MAX_BUS		3
#define EEPROM_BUS	4
#define LED_BUS		5
#define LAST_BUS	LED_BUS

extern int get_i2c_addr(int);
extern int get_mux();
```

## src/pmbus.c
```c
#include <stdlib.h>
#include <sys/byteorder.h>

#include <zephyr/device.h>
#include <zephyr/drivers/i2c.h>
#include <zephyr/zephyr.h>
#include <zephyr/shell/shell.h>
#include <zephyr/console/console.h>

#include "lib.h"
#include "pmbus.h"
#include "pmbus_cmds.h"
#include "my2c.h"
#include "vrails.h"
#include "irps5401.h"
#include <errno.h>
#include <string.h>
#include <math.h>
#include <stdio.h>

/* is PEC supported */
// #define PEC 1	/* To turn on */
#undef PEC

#ifdef PEC
// Note that crc8 can be pre-calculated into an array of 256 bytes
static unsigned char
crc8(unsigned char x)
{
	int i;

	for (i=0; i<8; i++) {
		char toxor = (x & 0x80) ? 0x07 : 0;

		x = x << 1;
		x = x ^ toxor;
	}

	return x;
}

static unsigned char
smbus_pec(unsigned char crc, const unsigned char *p, int count)
{
	int i;

	for (i = 0; i < count; i++)
		crc = crc8(crc ^ p[i]);
	return crc;
}
#endif
int twos_5bit(int v)
{
	int val;

	if (v == 0)
		return 0;
	val = (v ^ 0x1f) + 1;
	// printf("v= 0x%x, val = 0x%d\n", v, val);
	return -val;
}

int
encode(double v, int type)
{
	double tmp;
	int t;
	if (type == PM_LINEAR8) {
		tmp = v/(pow(2, -8));
		t = (int)tmp;
		return t;
	}
	return 0;
}

double
decode(unsigned short v, int type)
{
	if (type == PM_LINEAR8)
		return (v*pow(2, -8));
	else if (type == PM_LINEAR9)
		return (v*pow(2, -9));
	else if (type == PM_IOUT) {
		double tmp = (double) (v*pow(2, -8));
		tmp =  mytrunc(tmp, 125);
		return tmp/1000;
	} else if (type == PM_LINEAR11) {
		int exp = (v >> 11) & 0x1f;
		exp = twos_5bit(exp);
		v = v & 0x7ff;
		return (v * pow(2, exp));
	} else if (type == PM_LINEAR2) {
		v = v & 0x7ff;	// 11 bits
		return (v*pow(2, -2));
	} else if (type == PM_MAX_TEMP) {
		double i = (double) v;
		i = i * 10;		// * 10^-r, where r=-1 so 10...
		i = i - 5887;	// - b, where b=5887
		i = i / 21.0;	// divided by m, where m is 21.
		return i;
	} else if (type == PM_MAX_CURRENT) {
		struct power_vals pwr;
		
		// Formula from MAX AN6140
		// printk("MAXcurrent\n");
		double vout;
		double vin;

		pmbus_get_vout(VDD_1R2_DDR, &pwr);
		vout = pwr.fval;
		
		pmbus_get_vin(VDD_1R2_DDR, &pwr);
		vin = pwr.fval;
		double d = vout/vin;

		// printk("vin = %f, vout = %f\n", vin, vout);

		double b = 4976.0 - (131.0 * d);
		double m = 153.0 + (5.61 * d);
		double a = 0.013;
		double i = (double) v;
		pmbus_get_temp(VDD_1R2_DDR, &pwr);
		double temp = pwr.fval;

		i = i * 10;		// * 10^-r, where r=-1 so 10...
		i = i - b;
		i = i / m;
		i = i + (a * (temp-50.0));
		return i;
	} else if (type == PM_MAX_VIN) {
		// Formula from MAX AN6140
		// printk("v=%d\n", v);
		double volt = (double) v;
		volt *= 100.0;	// 10 ^ (-(-2)) --> 10 ^2 --> 100
		volt /= 3609.0;
		//printk("return volt=%f\n", volt);
		return volt;
	} else {
		printk("Unsupported format\n");
		return -1;
	}
}

static int
pm_rd_common(int bus, int command, int length, unsigned char *data, int blk)
{
	int i = 0;

	unsigned char tmp[130];
	int i2c_addr = get_i2c_addr(bus);

	set_mux(bus);
	k_sleep(K_MSEC(1));
	set_mux(bus);

	if (i2c_read_bytes(i2c_addr, command, tmp, length + blk) < 0) {
		printk("PMBUS: Read error bus: %d, i2c_addr: 0x%x\n", bus, i2c_addr);
		return -EIO;
	}
			
	
#if 0
	{
		for (i = 0; i < 4; i++) {
			printk("0x%02x ", tmp[i]);
		}
		printk("\n");
	}
#endif

	if (blk) {
		printk("Blk=0x%02x\n", tmp[0]);
		for (i = 0; i < length; i++) {
			tmp[i] = tmp[i+blk];
		}
		tmp[i] = 0;
	}
	i = 0;
	while (length > 0) {
		//printk("i=%d, length=%d\n", i, length);
		data[i] = tmp[length-1];
		i++, length--;
	}
	return 0;
}
static int
pmbus_wr_common(int bus, int command, int length, unsigned char *data, int blk)
{
	unsigned char sendbuf[131];
	int i2c_addr = get_i2c_addr(bus);

	set_mux(bus);

	//printk("wr: length=0x%x, blk=%d\n", length, blk);
	if (blk) {
		sendbuf[0] = length;
		memcpy(sendbuf+1, data, length);
		length++;
	} else {
		memcpy(sendbuf, data, length);
	}
#if 0
	int i;
	for (i=0; i<8; i++) {
		printk("0x%02x ", sendbuf[i]);
	}
	printk("\n");
#endif
	return i2c_write_bytes(i2c_addr, command, sendbuf, length);
}


int pmbus_read(int pmdev, int command, int length, unsigned char *data)
{
	return pm_rd_common(pmdev, command, length, data, FALSE);
}

int
pmbus_rdblock(int pmdev, int command, int length, unsigned char *data)
{
	return pm_rd_common(pmdev, command, length, data, TRUE);
}

int
pmbus_wrblock(int pmdev, int command, int length, unsigned char *data)
{
	return pmbus_wr_common(pmdev, command, length, data, TRUE);
}

int
pmbus_write(int pmdev, int command, int length, unsigned char *data)
{
	return pmbus_wr_common(pmdev, command, length, data, FALSE);
}

int
pmbus_get_iout(int rail, struct power_vals *pwr)
{
	unsigned char id[8];
	unsigned short v;
	int fmt;

	memset(&pwr, sizeof(struct power_vals), 0);
	int bus = get_bus(rail);
	// printk("pmbus_get_iout: rail=%d, bus=%d\n", rail, bus);

	if (bus < 0)
		return -1;

	int type = vrail[rail].type;
	// printk("type=0x%08x\n", type);
	// only IRPS supports page.
	if (type & ISIRPS_CHIP) {
		irps_setpage(bus, (unsigned char)type&LOOP_MASK);
	}

	pmbus_read(bus, PMBUS_READ_IOUT, 2, id);
	v = toshort(id);
	pwr->sval = v & 0xffff;
	// printk("Read I got 0x%x 0x%x (v=0x%x)\n", id[0], id[1], v);
	if (vrail[rail].type & ISMAX_CHIP)
		fmt = PM_MAX_CURRENT;
	else
		fmt = PM_LINEAR11;
	pwr->fval = decode(v, fmt);
	// printk("get_iout return %f\n", pwr->fval);
	return 0;
}


int
pmbus_get_temp(int rail, struct power_vals *pwr)
{
	unsigned char id[8];
	unsigned short v;
	int fmt;

	memset(&pwr, sizeof(struct power_vals), 0);
	int bus = get_bus(rail);
	// printk("pmbus_get_temp: rail=%d, bus=%d\n", rail, bus);

	if (bus < 0)
		return -1;

	int type = vrail[rail].type;
	// only IRPS supports page.
	if (type & ISIRPS_CHIP) {
		irps_setpage(bus, (unsigned char)type&LOOP_MASK);
	}

	pmbus_read(bus, PMBUS_READ_TEMPERATURE_1, 2, id);
	// printk("Read Temp got 0x%x 0x%x\n", id[0], id[1]);
	v = toshort(id);
	pwr->sval = v & 0xffff;
	if (vrail[rail].type & ISMAX_CHIP)
		fmt = PM_MAX_TEMP;
	else
		fmt = PM_LINEAR11;
	pwr->fval = decode(v, fmt);
	return 0;
}

int
pmbus_get_volt(int rail, struct power_vals *p)
{
	int rval = 0;
	//printk("Rail = %d, type = 0x%08x\n", rail, vrail[rail].type);

	if (vrail[rail].type & PMBUS_RD) {
		return pmbus_get_vout(rail, p);
	}
	if (vrail[rail].waitpg(rail))
		p->fval = vrail[rail].nominal;
	else {
		p->fval = 0.0;
	}
	return rval;
}

int
pmbus_set_vout(int rail, double volts)
{
	int bus = get_bus(rail);
	int raw;

	if (bus < 0) {
		// printk("pmbus_get_vout: Ret err\n");
		return -1;
	}

	int type = vrail[rail].type;
	// only IRPS supports page.
	if (type & ISIRPS_CHIP) {
		irps_setpage(bus, (unsigned char)type&LOOP_MASK);
	}

	char v[20];
	sprintf(v, "%.4f", volts);

	printk("pmbus set volt to %s\n", v);
	//pmbus_write(bus, PMBUS_VOUT_COMMAND, 2, buf);
	raw = encode(volts, PM_LINEAR8);
	printk("raw = %d (0x%x)\n", raw, raw);
	return 0;
}

int
pmbus_get_vout(int rail, struct power_vals *pwr)
{
	unsigned char id[8];
	unsigned short v;
	double volt;

	memset(&pwr, sizeof(struct power_vals), 0);
	int bus = get_bus(rail);

	if (bus < 0) {
		// printk("pmbus_get_vout: Ret err\n");
		return -1;
	}

	int type = vrail[rail].type;
	// only IRPS supports page.
	if (type & ISIRPS_CHIP) {
		irps_setpage(bus, (unsigned char)type&LOOP_MASK);
	}
	pmbus_read(bus, PMBUS_READ_VOUT, 2, id);
	v = toshort(id);
	pwr->sval = v & 0xffff;
	if (type & ISMAX_CHIP) {
		double RFB1 = 1.87 * 1000;
		double RFB2 = 2.21 * 1000;
#if 0
		printk("----id=%x %x %x %x, v = 0x%x---\n",
			   id[0], id[1], id[2], id[3], v);
#endif
		volt = decode(v, PM_LINEAR9);
		volt = volt * (1 + (RFB1/RFB2));
	} else {
		volt = decode(v, PM_LINEAR8);
	}
	if (type & DIVBY2)
		volt /= 2.0;
	pwr->fval = volt;

	//printk("volt=%f\n", volt);
	//printk("Returning volt=%f\n", pwr->fval);
	return 0;
}


int
pmbus_get_vin(int rail, struct power_vals *pwr)
{
	unsigned char id[8];
	unsigned short v;

	memset(&pwr, sizeof(struct power_vals), 0);
	int bus = get_bus(rail);

	if (bus < 0)
		return -1;

	int type = vrail[rail].type;
	// only IRPS supports page.
	if (type & ISIRPS_CHIP) {
		irps_setpage(bus, (unsigned char)type&LOOP_MASK);
	}
	pmbus_read(bus, PMBUS_READ_VIN, 2, id);
	v = toshort(id);
	pwr->sval = v & 0xffff;
	if (type & ISMAX_CHIP) {
#if 0
		printk("pm_get_vin: id=%x %x %x %x, v = 0x%x---\n",
			   id[0], id[1], id[2], id[3], v);
#endif
		pwr->fval = decode(v, PM_MAX_VIN);
	} else {
		pwr->fval = decode(v, PM_LINEAR8);
	}
	return 0;
}
```

## src/pmbus_cmds.h
```c
#ifndef __PMBUS_CMDS_H
#define __PMBUS_CMDS_H

#include <zephyr/sys/util_macro.h>



extern int pmbus_get_vout(int, struct power_vals *);
extern int pmbus_get_vin(int, struct power_vals *);
extern int pmbus_get_iout(int, struct power_vals *);
extern int pmbus_get_temp(int, struct power_vals *);
extern int pmbus_set_vout(int, double);
extern double decode(unsigned short, int);
extern int pmbus_regnull(int, struct pmbus_op *);

#endif /* __PMBUS_CMDS_H */
```

## src/vrails.c
```c
#include "vrails.h"
#include "my2c.h"
#include "irps5401.h"
#include "pmbus_cmds.h"

struct VoltRails vrail[] = {
	[VDD_0R85] = {NULL, NULL, "0R85 (A)", 0.85,
		GPIO_EN|GPIO_PG|GPIO_RD|ISIRPS_CHIP|LOOPA, vrail_on, vrail_off,
		vrail_wait_pg, vrail_pg, pmbus_get_volt, irps_reg},
	[VDD_1R8] = {NULL, NULL, "1R8 (D)", 1.8,
		PMBUS_EN|GPIO_PG|PMBUS_RD|LOOPD|ISIRPS_CHIP, vrail_on, vrail_off,
		vrail_wait_pg, vrail_pg, pmbus_get_volt, irps_reg},
	// VDD_3R3 has no power good signal yet! 
	[VDD_3R3] = {NULL, NULL, "3R3", 3.3, GPIO_EN|GPIO_RD, vrail_on, vrail_off,
		vrail_wait_pg, vrail_pg, pmbus_get_volt, pmbus_regnull},
	[VDD_1R2_DDR] = {NULL, NULL, "1R2_DDR/MGT", 1.2,
		GPIO_EN|GPIO_PG|PMBUS_RD|ISMAX_CHIP, vrail_on, vrail_off,
		vrail_wait_pg, vrail_pg, pmbus_get_volt, pmbus_regnull},
	[VDD_0R6] = {NULL, NULL, "0R6", 0.6, GPIO_EN|GPIO_PG|GPIO_RD, vrail_on,
		vrail_off, vrail_wait_pg, vrail_pg, pmbus_get_volt, pmbus_regnull},
	[VDD_2R5] = {NULL, NULL, "2R5 (B)", 2.5,
		PMBUS_EN|GPIO_PG|PMBUS_RD|LOOPB|ISIRPS_CHIP, vrail_on, vrail_off,
		vrail_wait_pg, vrail_pg, pmbus_get_volt, irps_reg},
	[VDD_0R9] = {NULL, NULL, "0R9 (C)", 0.9,
		PMBUS_EN|GPIO_PG|PMBUS_RD|LOOPC|ISIRPS_CHIP, vrail_on, vrail_off,
		vrail_wait_pg, vrail_pg, pmbus_get_volt, irps_reg},
	[VDD_1R0] = {NULL, NULL, "1R0 (LDO)", 1.0,
		PMBUS_EN|GPIO_PG|PMBUS_RD|LOOPLDO|ISIRPS_CHIP|DIVBY2, vrail_on,
		vrail_off, vrail_wait_pg, vrail_pg, pmbus_get_volt, irps_reg}
};

int
vrail_on(int rail)
{
	int bus = get_bus(rail);

	//printk("vrail_on rail=%d type=0x%08x, bus=%d\n", rail, vrail[rail].type, bus);
	if (vrail[rail].type & PMBUS_EN) {
		irps_setop(bus, vrail[rail].type & LOOP_MASK, VOLT_ON);
	} else if  (vrail[rail].type & GPIO_EN) {
		gpio_pin_set_dt(vrail[rail].enable_node, 1);
	} else {
		printk("unknown on/off!!\n");
		return POWER_BAD;
	}
	return vrail[rail].waitpg(rail);
}

int
vrail_off(int rail)
{
	int bus = get_bus(rail);

	if (vrail[rail].type & PMBUS_EN) {
		irps_setop(bus, vrail[rail].type & LOOP_MASK, VOLT_OFF);
	} else if  (vrail[rail].type & GPIO_EN) {
		gpio_pin_set_dt(vrail[rail].enable_node, 0);
	} else {
		printk("unknown on/off!!\n");
	}
	return 0;
}

/*
 * return POWER_GOOD (1) in PG, else POWER_BAD (0)
 */
int
vrail_pg(int rail)
{
	// only for 3r3
	if (vrail[rail].isgood_node == NULL) {
		//printk("PG good unset! (rail=%d)\n", rail);
		return POWER_GOOD;
	}
	if ((vrail[rail].type & GPIO_PG) != GPIO_PG) {
		printk("PG not set rail=%d!!!!!!\n", rail);
		return POWER_BAD;
	}
	if (gpio_pin_get_dt(vrail[rail].isgood_node) == 1)
		return POWER_GOOD;

	return POWER_BAD;
}

int
vrail_wait_pg(int rail)
{
	int delay = 50;

	while (delay--) {
		if (vrail_pg(rail) == POWER_GOOD)
			return POWER_GOOD;
		k_sleep(K_MSEC(10));
	}
	return POWER_BAD;
}

int
vrail_setvolt(int rail, double v)
{
	if (vrail[rail].type & PMBUS_RD) {
		return pmbus_set_vout(rail, v);
	}
	// Couldn't set
	return -1;
}

int get_bus(int rail)
{
	int typ = vrail[rail].type;

	if (typ & ISIRPS_CHIP)
		return IRPS_BUS;
	else if (typ & ISMAX_CHIP)
		return MAX_BUS;
	else {
		return -1;
	}
}


int
set_vrails(int sense, int sleep, int wait)
{
	printk("\nsetting vrails %s\n", (sense==POWER_ON)?"on":"off");
	int i;
	if (sense == POWER_ON) {
		i = 0;
		while(i < NUM_RAILS) {
			vrail_on(i);
		    vrail_wait_pg(i);	// wait for PG....
			if (sleep > 0)
				k_sleep(K_MSEC(1000*sleep));
			else if (wait) {
				//printk("press key to continue: ");
				//c=console_getchar();
				//printk("BACK\n");
			}
			i++;
		}
		// ON, set POR=0 after turning on..
		set_ps_bit(SET_POR, 0);
	} else {
		// point to last one
		i = NUM_RAILS-1;
		// OFF, set POR=1 before turning off..
		set_ps_bit(SET_POR, 1);
		while (i >= 0) {
			vrail_off(i);
			if (sleep > 0)
				k_sleep(K_MSEC(1000*sleep));			else if (wait) {
				//printk("press key to continue: ");
				//c=console_getchar();
				//printk("BACK\n");
			}
			i--;
		}
	}
	return 0;
}
```
