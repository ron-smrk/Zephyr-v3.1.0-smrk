## CMakeLists.txt
```
# SPDX-License-Identifier: Apache-2.0

cmake_minimum_required(VERSION 3.20.0)
find_package(Zephyr REQUIRED HINTS $ENV{ZEPHYR_BASE})
project(shell_module)

target_sources(app PRIVATE src/main.c src/my2c.c src/lib.c src/led.c src/boardctl.c src/gpio.c src/pmbus.c src/irps5401.c src/vrails.c src/pmbus_cmds.c)
```

## prj.conf
```kconfig
CONFIG_PRINTK=y
CONFIG_SHELL=y
CONFIG_LOG=y
CONFIG_INIT_STACKS=y
CONFIG_THREAD_STACK_INFO=y
CONFIG_KERNEL_SHELL=y
CONFIG_THREAD_MONITOR=y
CONFIG_BOOT_BANNER=n
CONFIG_THREAD_NAME=y
CONFIG_DEVICE_SHELL=y
CONFIG_POSIX_CLOCK=y
CONFIG_DATE_SHELL=y
CONFIG_THREAD_RUNTIME_STATS=y
CONFIG_THREAD_RUNTIME_STATS_USE_TIMING_FUNCTIONS=y
CONFIG_STATS=y
CONFIG_STATS_SHELL=y

CONFIG_REBOOT=y

CONFIG_GPIO=y
CONFIG_I2C=y
 
CONFIG_I2C_SHELL=y
 
CONFIG_SENSOR_SHELL=y
CONFIG_SENSOR=y

CONFIG_RAM_CONSOLE=y
#CONFIG_MINIMAL_LIBC_MALLOC_ARENA_SIZE=1024
CONFIG_NEWLIB_LIBC=y
```

## src/main.c
```c
/*
 * Copyright (c) 2015 Intel Corporation
 *
 * SPDX-License-Identifier: Apache-2.0
 */

#include <zephyr/zephyr.h>
#include <zephyr/shell/shell.h>
#include <version.h>
#include <zephyr/logging/log.h>
#include <stdlib.h>
#include <zephyr/drivers/uart.h>
#include <zephyr/usb/usb_device.h>
#include <ctype.h>
#include "lib.h"
#include "pmbus.h"
#include "vrails.h"

LOG_MODULE_REGISTER(app);

#if defined CONFIG_SHELL_GETOPT
/* Thread save usage */
static int cmd_demo_getopt_ts(const struct shell *sh, size_t argc,
			      char **argv)
{
	struct getopt_state *state;
	char *cvalue = NULL;
	int aflag = 0;
	int bflag = 0;
	int c;

	while ((c = getopt(argc, argv, "abhc:")) != -1) {
		state = getopt_state_get();
		switch (c) {
		case 'a':
			aflag = 1;
			break;
		case 'b':
			bflag = 1;
			break;
		case 'c':
			cvalue = state->optarg;
			break;
		case 'h':
			/* When getopt is active shell is not parsing
			 * command handler to print help message. It must
			 * be done explicitly.
			 */
			shell_help(sh);
			return SHELL_CMD_HELP_PRINTED;
		case '?':
			if (state->optopt == 'c') {
				shell_print(sh,
					"Option -%c requires an argument.",
					state->optopt);
			} else if (isprint(state->optopt)) {
				shell_print(sh,
					"Unknown option `-%c'.",
					state->optopt);
			} else {
				shell_print(sh,
					"Unknown option character `\\x%x'.",
					state->optopt);
			}
			return 1;
		default:
			break;
		}
	}

	shell_print(sh, "aflag = %d, bflag = %d", aflag, bflag);
	return 0;
}

static int cmd_demo_getopt(const struct shell *sh, size_t argc,
			      char **argv)
{
	char *cvalue = NULL;
	int aflag = 0;
	int bflag = 0;
	int c;

	while ((c = getopt(argc, argv, "abhc:")) != -1) {
		switch (c) {
		case 'a':
			aflag = 1;
			break;
		case 'b':
			bflag = 1;
			break;
		case 'c':
			cvalue = optarg;
			break;
		case 'h':
			/* When getopt is active shell is not parsing
			 * command handler to print help message. It must
			 * be done explicitly.
			 */
			shell_help(sh);
			return SHELL_CMD_HELP_PRINTED;
		case '?':
			if (optopt == 'c') {
				shell_print(sh,
					"Option -%c requires an argument.",
					optopt);
			} else if (isprint(optopt)) {
				shell_print(sh, "Unknown option `-%c'.",
					optopt);
			} else {
				shell_print(sh,
					"Unknown option character `\\x%x'.",
					optopt);
			}
			return 1;
		default:
			break;
		}
	}

	shell_print(sh, "aflag = %d, bflag = %d", aflag, bflag);
	return 0;
}

static int cmd_demo_params(const struct shell *shell, size_t argc, char **argv)
{
	shell_print(shell, "argc = %zd", argc);
	for (size_t cnt = 0; cnt < argc; cnt++) {
		shell_print(shell, "  argv[%zd] = %s", cnt, argv[cnt]);
	}

	return 0;
}

static int cmd_demo_hexdump(const struct shell *shell, size_t argc, char **argv)
{
	shell_print(shell, "argc = %zd", argc);
	for (size_t cnt = 0; cnt < argc; cnt++) {
		shell_print(shell, "argv[%zd]", cnt);
		shell_hexdump(shell, argv[cnt], strlen(argv[cnt]));
	}

	return 0;
}
#endif

static int cmd_version(const struct shell *shell, size_t argc, char **argv)
{
	ARG_UNUSED(argc);
	ARG_UNUSED(argv);

	shell_print(shell, "Version %s", KERNEL_VERSION_STRING);

	return 0;
}

SHELL_CMD_ARG_REGISTER(version, NULL, "Show kernel version", cmd_version, 1, 0);

void main(void)
{
	printk("\nWelcome to smrk100g (%s)", KERNEL_VERSION_STRING);

	setup_dev(DEV_SET);
	//printk("VDD 3.3 on.\n");
	set_ps_bit(SET_ALL, 1);
	//vrail_on(VDD_3R3);
	set_vrails(POWER_ON, 0, 0);
	init_cpu();

#if DT_NODE_HAS_COMPAT(DT_CHOSEN(zephyr_shell_uart), zephyr_cdc_acm_uart)
	const struct device *dev;
	uint32_t dtr = 0;

	dev = DEVICE_DT_GET(DT_CHOSEN(zephyr_shell_uart));
	if (!device_is_ready(dev) || usb_enable(NULL)) {
		return;
	}

	while (!dtr) {
		uart_line_ctrl_get(dev, UART_LINE_CTRL_DTR, &dtr);
		k_sleep(K_MSEC(100));
	}
#endif
}

struct pin {
	char *name;		/* name */
	int cval;		/* current value */
	int	func;		/* SET_POR, etc */
};
struct pin pintab[] = {
	{"srst", 0, SET_SRST},
	{"por", 0, SET_POR},
	{"prog", 0, SET_PROG},
	{"all", 0, SET_ALL},
	{NULL, 0, 0}
};
		
int
set_cmd(const struct shell *shell, size_t argc, char *argv[])
{
	int i;
	if (argc == 1) {
		printk("\n");
		for (i = 0; pintab[i].func != SET_ALL; i++)
			printk("%s: %d\n", pintab[i].name, pintab[i].cval);
		return 0;
	}
	
	if (argc != 3) {
		printk("usage set <LINE> <VALUE>\n");
		return -1;
	}
	char *line = toLower(argv[1]);
	int val = atoi(argv[2]);

	if ((val < 0) || (val > 1)) {
		printk("val must be 1 or 0\n");
		return -1;
	}

	int match = 0;
	for (i = 0; pintab[i].name; i++) {
		if (strcmp(line, pintab[i].name) == 0) {
			set_ps_bit(pintab[i].func, val);
			if (pintab[i].func == SET_ALL) {
				int i2;
				for (i2 = 0; pintab[i2].func != SET_ALL; i2++) {
					pintab[i2].cval = val;
				}
			} else {
				pintab[i].cval = val;
			}
			match++;
		}
	}
	if (match)
		return 0;

	printk("line must one of: ");
	for (i = 0; pintab[i].name; i++) {
		printk("%s ", pintab[i].name);
	}
	printk("\n");
	return -1;
}
SHELL_CMD_ARG_REGISTER(set, NULL, "set <LINE> <VAL>", set_cmd, 0, 0);

struct pin status[] = {
	{"done_b", 0, GET_DONE_B},
	{"init", 0, GET_INIT},
	{NULL, 0, 0}
};

int
get_cmd(const struct shell *shell, size_t argc, char *argv[])
{
	int i;

	if (argc == 1) {
		printk("\n");
		for (i = 0; status[i].name; i++)
			printk("%s: %d\n", status[i].name, get_ps_stat(status[i].func));
		return 0;
	}
	if (argc != 2) {
		printk("usage get <LINE>\n");
		return -1;
	}

	char *line = toLower(argv[1]);
	int match = 0;
	for (i = 0; status[i].name; i++) {
		if (strcmp(line, status[i].name) == 0) {
			printk("\n%s: %d\n", status[i].name, get_ps_stat(status[i].func));
			match++;
		}
	}
	if (match)
		return 0;
	printk("line must be one of: " );
	for (i = 0; status[i].name; i++) {
		printk("%s ", status[i].name);
	}
	printk("\n");
	return -1;
}



SHELL_CMD_ARG_REGISTER(get, NULL, "get <LINE>", get_cmd, 0, 0);
	
```

## src/boardctl.c
```c
#include <stdlib.h>
#include <sys/byteorder.h>
#include <drivers/gpio.h>


#include "lib.h"
#include "gpio.h"
#include "pmbus.h"

#include "vrails.h"

char *i2c_dev = 0;
static int gpios_inited = 0;

#define EN_0R85_NODE DT_ALIAS(en_0r85)
static const struct gpio_dt_spec en_0r85 = GPIO_DT_SPEC_GET_OR(EN_0R85_NODE, gpios, {0});
#define PG_0R85_NODE DT_ALIAS(pg_0r85)
static const struct gpio_dt_spec pg_0r85 = GPIO_DT_SPEC_GET_OR(PG_0R85_NODE, gpios, {0});

#define PG_1R8_NODE DT_ALIAS(pg_1r8)
static const struct gpio_dt_spec pg_1r8 = GPIO_DT_SPEC_GET_OR(PG_1R8_NODE, gpios, {0});

#define EN_3R3_NODE	DT_ALIAS(en_3r3)
static const struct gpio_dt_spec en_3r3 = GPIO_DT_SPEC_GET(EN_3R3_NODE, gpios);
// Need PG_VDD_3R3

#define EN_1R2_DDR_NODE DT_ALIAS(en_1r2_ddr)
static const struct gpio_dt_spec en_1r2_ddr = GPIO_DT_SPEC_GET_OR(EN_1R2_DDR_NODE, gpios, {0});
#define PG_1R2_DDR_NODE DT_ALIAS(pg_1r2_ddr)
static const struct gpio_dt_spec pg_1r2_ddr = GPIO_DT_SPEC_GET_OR(PG_1R2_DDR_NODE, gpios, {0});

#define EN_0R6_NODE DT_ALIAS(en_0r6)
static const struct gpio_dt_spec en_0r6 = GPIO_DT_SPEC_GET_OR(EN_0R6_NODE, gpios, {0});
#define PG_0R6_NODE DT_ALIAS(pg_0r6)
static const struct gpio_dt_spec pg_0r6 = GPIO_DT_SPEC_GET_OR(PG_0R6_NODE, gpios, {0});


#define PG_2R5_NODE DT_ALIAS(pg_2r5)
static const struct gpio_dt_spec pg_2r5 = GPIO_DT_SPEC_GET_OR(PG_2R5_NODE, gpios, {0});

#define EN_1R2_MGT_NODE DT_ALIAS(en_1r2_mgt)
static const struct gpio_dt_spec en_1r2_mgt = GPIO_DT_SPEC_GET_OR(EN_1R2_MGT_NODE, gpios, {0});
#define PG_1R2_MGT_NODE DT_ALIAS(pg_1r2_mgt)
static const struct gpio_dt_spec pg_1r2_mgt = GPIO_DT_SPEC_GET_OR(PG_1R2_MGT_NODE, gpios, {0});

#define PG_0R9_NODE DT_ALIAS(pg_0r9)
static const struct gpio_dt_spec pg_0r9 = GPIO_DT_SPEC_GET_OR(PG_0R9_NODE, gpios, {0});

#define PG_1R0_NODE DT_ALIAS(pg_1r0)
static const struct gpio_dt_spec pg_1r0 = GPIO_DT_SPEC_GET_OR(PG_1R0_NODE, gpios, {0});

#define ZYNQ_PS_POR_NODE DT_ALIAS(zynq_ps_por)
static const struct gpio_dt_spec zynq_por = GPIO_DT_SPEC_GET(ZYNQ_PS_POR_NODE, gpios);

#define ZYNQ_PS_SRST_NODE DT_ALIAS(zynq_ps_srst)
static const struct gpio_dt_spec zynq_srst = GPIO_DT_SPEC_GET(ZYNQ_PS_SRST_NODE, gpios);

#define ZYNQ_PS_PROG_NODE DT_ALIAS(zynq_ps_prog)
static const struct gpio_dt_spec zynq_prog = GPIO_DT_SPEC_GET(ZYNQ_PS_PROG_NODE, gpios);


#define QSFP_RESETL_NODE DT_ALIAS(qsfp_resetl)
// Remove when used
__attribute__ ((unused))
static const struct gpio_dt_spec qsfp_reset = GPIO_DT_SPEC_GET(QSFP_RESETL_NODE, gpios);

#define QSFP_LPMODE_NODE DT_ALIAS(qsfp_lpmode)
// Remove when used
__attribute__ ((unused))
static const struct gpio_dt_spec qsfp_lowpower_mode = GPIO_DT_SPEC_GET(QSFP_LPMODE_NODE, gpios);

#define ZYNQ_PS_INIT_NODE DT_ALIAS(zynq_ps_init)
static const struct gpio_dt_spec zynq_init = GPIO_DT_SPEC_GET(ZYNQ_PS_INIT_NODE, gpios);

#define ZYNQ_PS_DONE_B_NODE DT_ALIAS(zynq_ps_done_b)
static const struct gpio_dt_spec zynq_done_b = GPIO_DT_SPEC_GET(ZYNQ_PS_DONE_B_NODE, gpios);
/*
 * if func == DEV_REINIT, reinitialize to default
 */
void
setup_dev(int func)
{
	//printk("func = %d, i2c_dev = %d\n", func, (int) i2c_dev);
	if ((func == DEV_REINIT) && i2c_dev) {
		free(i2c_dev);
		i2c_dev = NULL;
	}
	if (!i2c_dev) {
		i2c_dev = strdup(DEF_BUS);
	}

	if (!gpios_inited) {
		gpios_inited = 1;
		//gpio_dump_regs(XGPIOA);

		gpio_pin_configure_dt(&en_0r85, GPIO_OUTPUT);
		gpio_pin_configure_dt(&pg_0r85, GPIO_INPUT);
		vrail[VDD_0R85].enable_node = &en_0r85;
		vrail[VDD_0R85].isgood_node = &pg_0r85;

		gpio_pin_configure_dt(&pg_1r8, GPIO_INPUT);
		vrail[VDD_1R8].isgood_node = &pg_1r8;

		gpio_pin_configure_dt(&en_3r3, GPIO_OUTPUT);
		vrail[VDD_3R3].enable_node = &en_3r3;
		
		// Need pg_3r3....

		gpio_pin_configure_dt(&en_1r2_ddr, GPIO_OUTPUT);
		gpio_pin_configure_dt(&pg_1r2_ddr, GPIO_INPUT);
		vrail[VDD_1R2_DDR].enable_node = &en_1r2_ddr;
		vrail[VDD_1R2_DDR].isgood_node = &pg_1r2_ddr;

		gpio_pin_configure_dt(&en_0r6, GPIO_OUTPUT);
		gpio_pin_configure_dt(&pg_0r6, GPIO_INPUT);
		vrail[VDD_0R6].enable_node = &en_0r6;
		vrail[VDD_0R6].isgood_node = &pg_0r6;

		gpio_pin_configure_dt(&pg_2r5, GPIO_INPUT);
		vrail[VDD_2R5].enable_node = &pg_2r5;
		
		gpio_pin_configure_dt(&en_1r2_mgt, GPIO_OUTPUT);	
		gpio_pin_configure_dt(&pg_1r2_mgt, GPIO_INPUT);
		vrail[VDD_1R2_MGT].enable_node = &en_1r2_mgt;
		vrail[VDD_1R2_MGT].isgood_node = &pg_1r2_mgt;

		gpio_pin_configure_dt(&pg_0r9, GPIO_INPUT);
		vrail[VDD_0R9].isgood_node = &pg_0r9;

		gpio_pin_configure_dt(&pg_1r0, GPIO_INPUT);
		vrail[VDD_1R0].isgood_node = &pg_1r0;

		gpio_pin_configure_dt(&zynq_srst, GPIO_OUTPUT);
		gpio_pin_configure_dt(&zynq_por, GPIO_OUTPUT);
		gpio_pin_configure_dt(&zynq_prog, GPIO_OUTPUT);
		gpio_pin_configure_dt(&qsfp_lowpower_mode, GPIO_OUTPUT);

		gpio_pin_configure_dt(&zynq_init, GPIO_INPUT);
		gpio_pin_configure_dt(&zynq_done_b, GPIO_INPUT);

//gpio_dump_regs(XGPIOA);
		//gpio_dump_regs(XGPIOB);
		//gpio_dump_regs(XGPIOC);

	}
}

void
init_cpu()
{
	gpio_pin_set_dt(&zynq_srst, 0);
	gpio_pin_set_dt(&zynq_por, 0);

	k_sleep(K_MSEC(1));
	gpio_pin_set_dt(&zynq_prog, 0);

/* needed?? */
	k_sleep(K_MSEC(1));
	gpio_pin_set_dt(&zynq_prog, 1);

	k_sleep(K_MSEC(1));
	gpio_pin_set_dt(&zynq_prog, 0);
/* ************* */
}

void
set_ps_bit(int line, int val)
{
	switch(line) {
	case SET_POR:
		gpio_pin_set_dt(&zynq_por, val);
		break;
	case SET_SRST:
		gpio_pin_set_dt(&zynq_srst, val);
		break;
	case SET_PROG:
		gpio_pin_set_dt(&zynq_prog, val);
		break;
	case SET_ALL:
		gpio_pin_set_dt(&zynq_srst, val);
		gpio_pin_set_dt(&zynq_por, val);
		gpio_pin_set_dt(&zynq_prog, val);
		break;
	default:
		printk("bad line...\n");
	}
}

int get_ps_stat(int line)
{
	switch(line) {
	case GET_DONE_B:
		return gpio_pin_get_dt(&zynq_done_b);
	case GET_INIT:
		return gpio_pin_get_dt(&zynq_init);
	}
	printk("OOPS!!!\n");
	return 0xdeadbeef;
}
```

## src/gpio.c
```c
#include <stdlib.h>
#include <zephyr/logging/log.h>
#include <zephyr/drivers/i2c.h>
#include <zephyr/shell/shell.h>
#include <drivers/gpio.h>
#include <sys/byteorder.h>

#include "lib.h"
#include "gpio.h"


struct gpio {
	int rnum;
	char *desc;
} ginfo[] = { {GPIO_MODER, "MODER"},
	  {GPIO_OTYPER, "OTYPE"},
	  {GPIO_SPEEDR, "SPEEDR"},
	  {GPIO_PUPDR, "PUPDR"},
	  {GPIO_IDR, "IDR"},
	  {GPIO_ODR, "ODR"},
	  {GPIO_BSRR, "BSRR"},
	  {GPIO_LOCKR, "LOCKR"},
	  {GPIO_AFRL, "AFRL"},
	  {GPIO_AFRH, "AFRH"}
};

int gpiobase[] = { 0x40020000, 0x40020400, 0x40020800, 0x40020c00, 0x40021000 };
char *gpioname[] = {"GPIOA", "GPIOB", "GPIOC", "GPIOD", "GPIOE"};

void gpio_dump1(int port, int reg)
{
	unsigned int *p;
	
	p = (unsigned int *)gpiobase[port];
	
	printk("%-8s 0x%08x\n", ginfo[reg].desc, p[reg]);

}

/*
 * yes this needs a mask, clr then set...
 */
int gpio_set1(int port, int reg, int val)
{
	unsigned int *p;
	
	p = (unsigned int *)gpiobase[port];
	p[reg] |= val;
	return 0;
}

int gpio_dump_regs(int port)
{
	int i;
	
	if ((port < 0) || (port > XGPIO_LAST)) {
		printk("Bad port %d\n", port);
		return -1;
	}
	printk("%s:\n", gpioname[port]);
	for (i = 0; i < GPIO_LAST_REG; i++)
		gpio_dump1(port, i);
	return 0;
}
```

## src/gpio.h
```c
/*
 * GPIO Defs
 */
#define XGPIOA 0
#define XGPIOB 1
#define XGPIOC 2
#define XGPIOD 3
#define XGPIOE 4
#define XGPIO_LAST 2

#define GPIO_MODER	0
#define GPIO_OTYPER	1
#define GPIO_SPEEDR	2
#define GPIO_PUPDR  3
#define GPIO_IDR	4
#define GPIO_ODR	5
#define GPIO_BSRR	6
#define GPIO_LOCKR	7
#define GPIO_AFRL	8
#define GPIO_AFRH	9
#define GPIO_LAST_REG 10

extern void gpio_dump1(int, int);
extern int gpio_set1(int, int, int);
extern int gpio_dump_regs(int);
```

## src/irps5401.c
```c
#include <stdlib.h>
#include <sys/byteorder.h>

#include <zephyr/device.h>
#include <zephyr/drivers/i2c.h>
#include <drivers/gpio.h>
#include <zephyr/zephyr.h>
#include <zephyr/shell/shell.h>
#include "lib.h"
#include "pmbus.h"
#include "irps5401.h"
#include "pmbus_cmds.h"
#include "vrails.h"
#include "my2c.h"
#include <errno.h>
#include <string.h>
#include <math.h>

struct pm_list {
	unsigned char command;
	int size;
	char *name;
	char *units;
	int type;
} pm_info [] = {
	{PMBUS_READ_VOUT, 2, "Output Voltage", "V", PM_LINEAR8},
	{PMBUS_READ_IOUT, 2, "Output Current", "Amps", PM_IOUT},
	{PMBUS_READ_TEMPERATURE_1, 2, "Temperature", "Degrees C", PM_LINEAR11},
	{}
};

struct mapping {
	char *name;
	int val;
};

/*
 * Assume page is set already
 */
static int
dumpval(int bus, struct pm_list *p)
{
	unsigned char id[8];
	unsigned short v;
	printk("Read cmd: 0x%x, sz: 0x%x\n", p->command, p->size);
	pmbus_read(bus, p->command, p->size, id);
	printk("read 0x%02x 0x%02x\n", id[0], id[1]);
		  
	v = toshort(id);

	printk("Got 0x%x for value for %s type=%d units=%s\n", v, p->name, p->type, p->units);
	switch (p->type) {
	case PM_LINEAR8:
	case PM_LINEAR11:
	case PM_IOUT:
		printk("  %s: %.4f %s\n", p->name, decode(v, p->type), p->units);
		break;
	default:
		if (p->size == 1)
			printk("  %s = 0x%02x\n", p->name, v & 0xff);
		else
			printk("  %s = 0x%04x\n", p->name, v);
		break;
	}

	return 0;
}

static int
dumpall(int rail)
{
	struct pm_list *p;
	int bus = get_bus(rail);

	printk("dumpall got bus %d\n", bus);


	if (bus < 0)
		return -EIO;
	
	int type = vrail[rail].type;
	// only IRPS supports page.
	if (type & ISIRPS_CHIP) {
		if (irps_setpage(bus, (unsigned char)type&LOOP_MASK) < 0) {
			printk("Can't set page %d\n", rail);
			return -EIO;
		}
	}

	for (p = pm_info; p->name; p++) {
		dumpval(bus, p);
	}
	return 0;
}
int map(char *s, struct mapping *p)
{
	s = toLower(s);
	for (; p->name != NULL; p++) {
		if (strcmp(s, p->name) == 0) {
			return p->val;
		}
	}

	return -1;
}

struct mapping pstates[] = {
	{"0", VOLT_OFF},
	{"off", VOLT_OFF},
	{"1", VOLT_ON},
	{"on", VOLT_ON},
	{NULL,0}
};

static int getpstate(char *s)
{
	return map(s, pstates);
}

struct mapping looptab[] = {
	{"0", -2},
	{"1", VDD_2R5},
	{"2", VDD_0R9},
	{"3", VDD_1R8},
	{"4", VDD_1R0},
	{"a", -2},
	{"b", VDD_2R5},
	{"c", VDD_0R9},
	{"d", VDD_1R8},
	{"ldo", VDD_1R0},
	{"all", -1},
	{NULL,0}
};

static int
getrail(char *s)
{
	return map(s, looptab);
}

static int
irps_help(const struct shell *sh, size_t argc, char **argv)
{
	ARG_UNUSED(argc);
	ARG_UNUSED(argv);

	printk("\nirps usage:\n");

	printk("irps <dev> [on|off] - Turn device on/off\n");
	printk("irps <dev> dump - dump data associated with rail/loop\n");
	printk("dev may be:\n");
	printk("all - apply to all devices\n");
	printk("[0-4] - devices 0-4, Loops A-D, Loop LDO\n");
	printk("A|B|C|D|LDO (case insensitive)\n");
	return 0;
}

static int
irps_dump(const struct shell *sh, size_t argc, char **argv)
{
	char *dev = toLower(argv[1]);
	int rail;
	
	printk("\nDumping Device %s\n", dev);

	rail = getrail(dev);
	printk("rail = %d\n", rail);
	if (rail < 0) {
		printk("Bad rail %s\n", dev);
		return -1;
	}

	dumpall(rail);
#if 0
	double v;
	v = pmread_vout(0x40, rail);
	printk("V: %.4f\n", v);
#endif
	return 0;
}
static int
irps_main(const struct shell *sh, size_t argc, char **argv)
{
	int rail;
	int val;

	char *dev = toLower(argv[1]);
	char *state = toLower(argv[2]);

	rail = getrail(dev);
	printk("irps_main, rail=%d\n", rail);
	if (rail < 0) {
		printk("Command error: Bad rail %s\n", dev);
		return -1;
	}

	val = getpstate(state);
	
	if (val < 0) {
		printk("Command error: Bad power state %s\n", state);
		return -1;
	}
	printk("\nturning rail %s (%d) %s\n", dev, rail, state);
	irps_setop(IRPS_BUS, vrail[rail].type & LOOP_MASK, val);

	return 0;
}

			  
/******************************************************************
 * IRPS commands
 * irps help
 * irps <dev> [on|offp]
 * irps dump <dev>
 *
 * dev: 0-4, a-d, ldo, all
 */
SHELL_SUBCMD_SET_CREATE(sub_irps, (irps));
SHELL_SUBCMD_ADD((irps), help, NULL, "help for irps", irps_help, 1, 0);
SHELL_SUBCMD_ADD((irps), dump, NULL, "Dump Info", irps_dump, 2, 0);
//SHELL_CMD_REGISTER(irps, &sub_irps, "IRPS 5401 Commands", NULL);
SHELL_CMD_ARG_REGISTER(irps, &sub_irps, "IRPS 5401 Commands", irps_main, 1, 3);
```

## src/irps5401.h
```c
#ifndef __IRPS5401_H
#define __IRPS5401_H

#include <zephyr/sys/util_macro.h>


enum irps5401_registers {
	PMBUS_MFR_REG_ACCESS			= 0xD0, /* Block Write, R word */
	PMBUS_MFR_I2C_ADDRESS			= 0xD6, /* R/W byte */
	PMBUS_MFR_TPGDLY				= 0xD8, /* R/W word */
	PMBUS_MFR_FCCM					= 0xD9, /* R/W word */
	PMBUS_MFR_VOUT_PEAK				= 0xDB, /* R/W word */
	PMBUS_MFR_IOUT_PEAK				= 0xDC, /* R/W word */
	PMBUS_MFR_TEMPERATURE_PEAK		= 0xDD, /* R/W word */
	PMBUS_MFR_LDO_MARGIN			= 0xDE, /* R/W word */
};

#define LOOPA	0
#define LOOPB	1
#define LOOPC	2
#define LOOPD	3
#define LOOPLDO 4

#endif /* __IRPS5401_H */
```

## src/led.c
```c
#include <stdlib.h>
#include <zephyr/shell/shell.h>
#include <sys/byteorder.h>
#include "my2c.h"

#include "lib.h"

/*
 * Control individual LEDs (0-7)
 *
 * led LED <on|green|yellow|off>
 * LED: D8, D9, D10, D11
 * on is both LEDS on
 * D8 is closest to board, D11 furthest
 */
struct lmap {
	char *name;
	int  ypin; /* yellow */
	int  gpin; /* green */
	unsigned char mask; /* mask bits */
} ledmap[] = {
	{"d8", 3, 2, 0x0c},
	{"d9", 1, 0, 0x03},
	/* {"d10", 1, 0, 0xfc}, */
	/* {"d11", 6, 7, 0x3f}, */
	{0, 0, 0, 0}
};
	
		
static int cmd_led(const struct shell *sh, size_t argc, char **argv)
{
	char s[10];
	char buf[20];

	struct lmap *p;
	char *name = 0;
	int ypin = 0, gpin = 0;
	char gval = 0, tmp;
	unsigned char mask = 0;
	int all = 0;
	char gall = 0, yall = 0, allmask = 0;
	int val;
	
	p = &ledmap[0];
	strcpy(s, toLower(argv[1]));
	for (; p->name != NULL; p++) {
		if (strcmp(p->name, s) == 0 ) {
			name = p->name;
			ypin = p->ypin;
			gpin = p->gpin;
			mask = p->mask;
		}
		gall |= (1 << p->gpin);
		yall |= (1 << p->ypin);
		allmask |= p->mask;
	}
	if (!name) {
		if (s[0] == 'a') {
			all = 1;
			name = "all";
		} else {
			printk("Not found: %s\n", s);
			return -ENOENT;
		}
	}
#if 0
	printk("name: %s, ypin=%d, gpin=%d, mask=0x%x\n", name, ypin, gpin, mask);
	printk("yall=0x%x, gall = 0x%x, allmask = 0x%02x\n", yall, gall, allmask);
#endif
	strcpy(s, toLower(argv[2]));
	switch (s[0]) {
	case 'g':
		if (all)
			gval = gall;
		else
			gval = 1 << gpin;
		break;
	case 'y':
		if (all)
			gval = yall;
		else
			gval = 1 << ypin;
		break;
	case 'o':
		if (s[1] == 'n') {	/* on */
			if (all)
				gval |= (gall|yall);
			else
				gval = (1 << gpin) | (1 << ypin);
			break;
		} else if (s[1] == 'f') {
			gval = 0;
			break;
		} else {
			printk("Bad option: %s\n", s);
			return -ENOENT;
		}
	default:
		printk("Bad option: %s\n", s);
		return -ENOENT;

	}

	if (all)
		mask = allmask;

#if 0
	printk("gval = 0x%02x\n", gval);
	printk("mask = 0x%02x\n", mask);
#endif
	
	/* LED Controller is on I2C Bus 5 */
	set_mux(LED_BUS);

	/* Set all pins to output */	
	buf[0] = 0xff;
	i2c_write_bytes(LED_ADDR, 3, buf, 1);
	/* High impedence off */
	buf[0] = 0;
	i2c_write_bytes(LED_ADDR, 7, buf, 1);
	/* disbale PU/PD */
	buf[0] = 0;
	i2c_write_bytes(LED_ADDR, 0xb, buf, 1);
	/* write data */

	i2c_read_bytes(LED_ADDR, 5, buf, 1);
#if 0
	printk("read 0x%02x\n", buf[0]);
#endif

	tmp = buf[0];

	val = tmp & ~mask;
#if 0
	printk("val=0x%x\n", val);
	printk("tmp=0x%x, mask=0x%x, ~mask=0x%x\n", tmp, mask, ~mask);
#endif		
	   
	buf[0] = (tmp & ~mask) | gval;
	printk("writing 0x%02x\n", buf[0]);
	
	i2c_write_bytes(LED_ADDR, 5, buf, 1);

	return 0;
}

SHELL_CMD_ARG_REGISTER(led, NULL, "usage: led [d8|d9|all] [on|off|green|yellow]", cmd_led, 3, 0);
```

## src/lib.c
```c
#include <stdlib.h>
#include <string.h>
#include <ctype.h>
#include "lib.h"


#include <errno.h>

char *strdup(const char *s)
{
	char *dest = malloc(strlen(s)+1);

	if (dest) {
		strcpy(dest, s);
	}

	return dest;
}

/**
 * C++ version 0.4 char* style "itoa":
 * Written by Lukás Chmela
 * Released under GPLv3.
 */
char* itoa(int value, char* result, int base) {
    // check that the base if valid
    if (base < 2 || base > 36) { *result = '\0'; return result; }

    char *ptr = result, *ptr1 = result, tmp_char;
    int tmp_value;

    do {
        tmp_value = value;
        value /= base;
        *ptr++ = "zyxwvutsrqponmlkjihgfedcba9876543210123456789abcdefghijklmnopqrstuvwxyz" [35 + (tmp_value - value * base)];
    } while ( value );

    // Apply negative sign
    if (tmp_value < 0) *ptr++ = '-';
    *ptr-- = '\0';
    while(ptr1 < ptr) {
        tmp_char = *ptr;
        *ptr--= *ptr1;
        *ptr1++ = tmp_char;
    }
    return result;
}

char* toLower(char* s) {
  for(char *p=s; *p; p++) *p=tolower(*p);
  return s;
}
char* toUpper(char* s) {
  for(char *p=s; *p; p++) *p=toupper(*p);
  return s;
}

int
ishex(char *s)
{
	int i, len;
	len = strlen(s);
	if (len > MAX_ARGSZ_INT)
		return -EINVAL;
	for ( i = 0; i < len; i++ )
		if (!isxdigit(s[i]))
			return 0;
	return 1;
}

double
mytrunc(double f, int roundto)
{

	int x = (int)f;

	x = x+roundto;
	x = (x/roundto)*roundto;
	return (double) x;
}
```

## src/lib.h
```c
#include <stdlib.h>

#ifndef __MYLIB_H
#define __MYLIB_H

#define DEV_REINIT	0
#define DEV_SET	1
#define DEF_BUS		"I2C_1"
#define MAX_ARGSZ_INT	8

extern char *i2c_dev;
extern int rail;	/* voltage rail on irps5401 (0-4) */



extern int ishex(char *);
extern char *strdup(const char *);
extern char *itoa(int, char *, int);
extern char *toLower(char *);
extern char *toUpper(char *);
extern unsigned int toint(unsigned char *, int);
extern unsigned short toshort(unsigned char *);
extern double mytrunc(double, int);

extern void setup_dev(int);
extern void setup_pos(void);
extern int set_mux(int);
extern int i2c_write_bytes(int, int, char *, int);
extern int i2c_read_bytes(int, int, char *, int);

#endif /* __MYLIB_H */

#define TRUE	(1==1)
#define FALSE	(1==0)

#define VOLT_ON		1
#define  VOLT_OFF	0

#define SET_ALL		-1
#define SET_POR		0
#define SET_SRST	1
#define SET_PROG	2

#define GET_DONE_B	0
#define GET_INIT	1

extern void set_ps_bit(int, int);
```

## src/my2c.c
```c
/*
 * Copyright (c) 2018 Nordic Semiconductor ASA
 *
 * SPDX-License-Identifier: Apache-2.0
 */

#include <stdlib.h>
#include <zephyr/logging/log.h>
#include <zephyr/drivers/i2c.h>
#include <zephyr/shell/shell.h>
#include <drivers/gpio.h>
#include <sys/byteorder.h>

#include "my2c.h"
#include "lib.h"
#include "gpio.h"
static int get_bytes_count_for_hex(int);

LOG_MODULE_REGISTER(app_test);

#define MAX_BYTES_FOR_REGISTER_INDEX	4
#define MAX_I2C_BYTES	16

static int i2c_addresses[] = {
	[QSFP_BUS] = QSFP_ADDR,
	[EEP_BUS] = EEP_ADDR,
	[IRPS_BUS] = IRPS_ADDR,
	[MAX_BUS] = MAX_ADDR,
	[EEPROM_BUS] = EEPROM_ADDR,
	[LED_BUS] = LED_ADDR
};

int get_i2c_addr(int chip)
{
	if (chip > LAST_BUS)
		return -1;
	return i2c_addresses[chip];
}

static int i2c_scan(const struct shell *sh, size_t argc, char **argv)
{
	const struct device *d;
	uint8_t cnt = 0, first = 0x04, last = 0x77;

	/* ARG_UNUSED(argc); */
	/* ARG_UNUSED(argv); */

	d = device_get_binding(i2c_dev);

	if (!d) {
		shell_error(sh, "I2C: Device driver %s not found.",
			    i2c_dev);
		return -ENODEV;
	}
	shell_print(sh, "     0  1  2  3  4  5  6  7  8  9  a  b  c  d  e  f");
	for (uint8_t i = 0; i <= last; i += 16) {
		shell_fprintf(sh, SHELL_NORMAL, "%02x: ", i);
		for (uint8_t j = 0; j < 16; j++) {
			if (i + j < first || i + j > last) {
				shell_fprintf(sh, SHELL_NORMAL, "   ");
				continue;
			}

			struct i2c_msg msgs[1];
			uint8_t dst;

			/* Send the address to read from */
			msgs[0].buf = &dst;
			msgs[0].len = 0U;
			msgs[0].flags = I2C_MSG_WRITE | I2C_MSG_STOP;
			if (i2c_transfer(d, &msgs[0], 1, i + j) == 0) {
				shell_fprintf(sh, SHELL_NORMAL,
					      "%02x ", i + j);
				++cnt;
			} else {
				shell_fprintf(sh, SHELL_NORMAL, "-- ");
			}
		}
		shell_print(sh, "");
	}

	shell_print(sh, "%u devices found on %s",
		    cnt, i2c_dev);
	return 0;
}

/* #define LED0_NODE	DT_ALIAS(led0) */
/* static const struct gpio_dt_spec led = GPIO_DT_SPEC_GET(LED0_NODE, gpios); */

#define RST_NODE	DT_ALIAS(rstmux)
static const struct gpio_dt_spec resetmux = GPIO_DT_SPEC_GET(RST_NODE, gpios);
/* 
 * set I2C_BUS_NUMBER
 */
static int i2c_set_bus(const struct shell *sh, size_t argc, char **argv)
{
	int bus;
	ARG_UNUSED(argc);
	ARG_UNUSED(argv);

	//printk("Before setup\n");
	//gpio_dump_regs(XGPIOB);
 	bus = atoi(argv[1]);

	if ( (bus < 0) || (bus > 5)) {
		shell_error(sh, "BUS: %d, error: 0 <= BUSNUM <= 5", bus);
		return -ENODEV;
	}
	//shell_print(sh, "set executed, bus=%d", bus);
	set_mux(bus);
	return 0;
}
/* 
 * DEV I2C_BUS_NAME (I2C_1, etc)
 */
static int i2c_set_dev(const struct shell *sh, size_t argc, char **argv)
{
	ARG_UNUSED(argc);
	ARG_UNUSED(argv);

/*	
	printk("i2c_dev = %d\n", (int) i2c_dev);
	printk("arg[1] = %s\n", argv[1]);
*/
	if (argc == 1) {
		if (!i2c_dev) {
			shell_print(sh, "Current bus unset");
		} else {
			shell_print(sh, "Current bus: %s", i2c_dev);
		}
		return 0;
	}
	
	if (strcmp("-r", argv[1]) == 0) {
		setup_dev(DEV_REINIT);
		shell_print(sh, "I2C bus reset to %s", DEF_BUS);
		return 0;
	}
			

	if (i2c_dev != (char *)NULL) {
		free(i2c_dev);
	}
		
	i2c_dev = malloc(strlen(argv[1])+1);
	strcpy(i2c_dev, argv[1]);
	shell_print(sh,"I2c Bus changed to %s", i2c_dev);

	return 0;
}

int
reset_mux()
{
	int rval;

	if (!device_is_ready(resetmux.port)) {
		printk("Not ready mux\n");
		return -ENODEV;
	}
	rval = gpio_pin_configure_dt(&resetmux, GPIO_OUTPUT_ACTIVE);
	if (rval < 0) {
		printk("MUX config error: %d\n", rval);
		return -EIO;
	}

	// set type to open-drain
	gpio_set1(XGPIOB, GPIO_OTYPER, 0x20);
	// High Speed
	gpio_set1(XGPIOB, GPIO_SPEEDR, 0xc00);
	gpio_pin_set_dt(&resetmux, 0);
	k_msleep(10);
	gpio_pin_set_dt(&resetmux, 1);
	return 0;

}

static int current_mux = -1;
int
set_mux(int busid)
{
	int rval;
	char buf[20];
	
	// only write if different.
	if (current_mux == busid)
		return 0;
	
	if ((rval=reset_mux()) < 0)
		return rval;

	if ( (busid<0) > (busid>7) ) {
		printk("Bad BusID: %d\n", busid);
		return -1;
	}
	// printk("SetMux to %d\n", busid);
	buf[0] = 1<<busid;
	current_mux = busid;
	//printk("reset ok, setting bus to %d.\n", busid);
	i2c_write_bytes(0x74, 0, buf, 1);
	return 0;
	
}

int
i2c_read_bytes(int dev_addr, int reg_addr, char *obuf, int olen)
{
	uint8_t reg_addr_buf[MAX_BYTES_FOR_REGISTER_INDEX];
	int reg_addr_bytes;
	const struct device *dev;
	int ret;

	dev = device_get_binding(i2c_dev);
	if (!dev) {
		printk("I2C: Device driver %s not found.", i2c_dev);
		return -ENODEV;
	}
	reg_addr_bytes = get_bytes_count_for_hex(reg_addr);
	sys_put_be32(reg_addr, reg_addr_buf);


	ret = i2c_write_read(dev, dev_addr,
			     reg_addr_buf +
			       MAX_BYTES_FOR_REGISTER_INDEX - reg_addr_bytes,
			     reg_addr_bytes, obuf, olen);
	if (ret < 0) {
		printk("Failed to read from device: 0x%02x", dev_addr);
		return -EIO;
	}
#if 0
	printk("i2c_write_read: 0x%02x  0x%02x  0x%02x  0x%02x\n",
		   obuf[0], obuf[1], obuf[2], obuf[3]);
#endif
	return 0;
}

int
i2c_write_bytes(int dev_addr, int reg_addr, char *ibuf, int ilen)
{
	int ret;
	/* [ 16 + 4 - 1 ] */
	uint8_t buf[MAX_I2C_BYTES + MAX_BYTES_FOR_REGISTER_INDEX - 1];
	const struct device *dev;
	int reg_addr_bytes;

	dev = device_get_binding(i2c_dev);
	if (!dev) {
		printk("I2C: Device driver %s not found.", i2c_dev);
		return -ENODEV;
	}
	reg_addr_bytes = get_bytes_count_for_hex(reg_addr);
	//printk("Write to addr: 0x%x\n", dev_addr);
	//printk("Write to reg:  0x%x\n", reg_addr);

	sys_put_be32(reg_addr, buf);

	
	int i;
	for (i = 0; i < ilen; i++) {
		buf[MAX_BYTES_FOR_REGISTER_INDEX + i] = ibuf[i];
	}

#if 0
	for (i=0; i<8; i++) {
		printk("0x%02x ", buf[i]);
	}
	printk("\n");
#endif
	/* len is 2, 1 for register size, 1 for our data */
	ret = i2c_write(dev,
					buf + MAX_BYTES_FOR_REGISTER_INDEX - reg_addr_bytes,
					ilen+reg_addr_bytes, dev_addr);

	return 0;
}

static
int get_bytes_count_for_hex(int val)
{
	char arg[10];
	itoa(val, arg, 16);

	//printk("%d number is string %s\n", val, arg);
	int length = (strlen(arg) + 1) / 2;

	if (length > 1 && arg[0] == '0' && (arg[1] == 'x' || arg[1] == 'X')) {
		length -= 1;
	}

	return MIN(MAX_BYTES_FOR_REGISTER_INDEX, length);
		
}
SHELL_SUBCMD_SET_CREATE(sub_my2c, (my2c));

SHELL_SUBCMD_ADD((my2c), scan, NULL, "help for scan", i2c_scan, 1, 0);
SHELL_SUBCMD_ADD((my2c), set, NULL, "help for set", i2c_set_bus, 2, 0);
SHELL_SUBCMD_ADD((my2c), dev, NULL, "help for dev", i2c_set_dev, 1, 1);

SHELL_CMD_REGISTER(my2c, &sub_my2c, "I2C Control Functions", NULL);
```

## src/my2c.h
```c
#define QSFP_ADDR	0xFF	// Later...
#define EEP_ADDR	0xff	// also...
#define IRPS_ADDR	0x40
#define MAX_ADDR	0x54
#define EEPROM_ADDR	0x54
#define LED_ADDR	0x43

#define QSFP_BUS	0
#define EEP_BUS		1
#define IRPS_BUS	2
#define MAX_BUS		3
#define EEPROM_BUS	4
#define LED_BUS		5
#define LAST_BUS	LED_BUS

extern int get_i2c_addr(int);
```

## src/pmbus.c
```c
#include <stdlib.h>
#include <sys/byteorder.h>

#include <zephyr/device.h>
#include <zephyr/drivers/i2c.h>
#include <zephyr/zephyr.h>
#include <zephyr/shell/shell.h>
#include <zephyr/console/console.h>

#include "lib.h"
#include "pmbus.h"
#include "pmbus_cmds.h"
#include "my2c.h"
#include "vrails.h"
#include <errno.h>
#include <string.h>
#include <math.h>

/* is PEC supported */
// #define PEC 1	/* To turn on */
#undef PEC

#ifdef PEC
// Note that crc8 can be pre-calculated into an array of 256 bytes
static unsigned char
crc8(unsigned char x)
{
	int i;

	for (i=0; i<8; i++) {
		char toxor = (x & 0x80) ? 0x07 : 0;

		x = x << 1;
		x = x ^ toxor;
	}

	return x;
}

static unsigned char
smbus_pec(unsigned char crc, const unsigned char *p, int count)
{
	int i;

	for (i = 0; i < count; i++)
		crc = crc8(crc ^ p[i]);
	return crc;
}
#endif

#if 1

static int
pm_rd_common(int bus, int command, int length, unsigned char *data, int blk)
{
	int i = 0;

	unsigned char tmp[130];
	int i2c_addr = get_i2c_addr(bus);

	set_mux(bus);
	k_sleep(K_MSEC(1));
	set_mux(bus);

	if (i2c_read_bytes(i2c_addr, command, tmp, length + blk) < 0) {
		printk("PMBUS: Read error bus: %d, i2c_addr: 0x%x\n", bus, i2c_addr);
		return -EIO;
	}
			
	
#if 0
	{
		for (i = 0; i < 4; i++) {
			printk("0x%02x ", tmp[i]);
		}
		printk("\n");
	}
#endif

	if (blk) {
		printk("Blk=0x%02x\n", tmp[0]);
		for (i = 0; i < length; i++) {
			tmp[i] = tmp[i+blk];
		}
		tmp[i] = 0;
	}
	i = 0;
	while (length > 0) {
		//printk("i=%d, length=%d\n", i, length);
		data[i] = tmp[length-1];
		i++, length--;
	}
	return 0;
}
static int
pmbus_wr_common(int bus, int command, int length, unsigned char *data, int blk)
{
	unsigned char sendbuf[131];
	int i2c_addr = get_i2c_addr(bus);

	set_mux(bus);

	//printk("wr: length=0x%x, blk=%d\n", length, blk);
	if (blk) {
		sendbuf[0] = length;
		memcpy(sendbuf+1, data, length);
		length++;
	} else {
		memcpy(sendbuf, data, length);
	}
#if 0
	int i;
	for (i=0; i<8; i++) {
		printk("0x%02x ", sendbuf[i]);
	}
	printk("\n");
#endif
	return i2c_write_bytes(i2c_addr, command, sendbuf, length);
}


int pmbus_read(int pmdev, int command, int length, unsigned char *data)
{
	return pm_rd_common(pmdev, command, length, data, FALSE);
}

int
pmbus_rdblock(int pmdev, int command, int length, unsigned char *data)
{
	return pm_rd_common(pmdev, command, length, data, TRUE);
}

int
pmbus_wrblock(int pmdev, int command, int length, unsigned char *data)
{
	return pmbus_wr_common(pmdev, command, length, data, TRUE);
}

int
pmbus_write(int pmdev, int command, int length, unsigned char *data)
{
	return pmbus_wr_common(pmdev, command, length, data, FALSE);
}

#else
int
pmbus_write(int addr, int command, int length, unsigned char *data)
{
	unsigned char sendbuf[131];
	int pec_len = 0;

	if (length > 128)
		return -EINVAL;
	printk("pmbus_write: 0x%x, 0x%x\n", addr, command);

	sendbuf[0] = command;
	memcpy(sendbuf + 1, data, length);
	printk("pmbus_write: 0x%x, 0x%x\n", addr, command);
#ifdef PEC
	sendbuf[length + 1] = smbus_pec(0, sendbuf, length+1);
	pec_len = 1;
	printk("pmbus_write: PEC=0x%x\n", sendbuf[length+1]);
#endif /* PEC */
	{
		printk("WR Buf: 0x%02x 0x%02x 0x%02x 0x%02x\n", sendbuf[0], sendbuf[1],
			   sendbuf[2], sendbuf[3]);
	}

	struct i2c_msg msg;
	const struct device *dev;

	dev = device_get_binding(i2c_dev);
	if (!dev) {
		printk("I2C: Device driver %s not found.", i2c_dev);
		return -ENODEV;
	}

	msg.buf = sendbuf;
	msg.len = length + 1 + pec_len;
	msg.flags = I2C_MSG_WRITE | I2C_MSG_STOP;
	return i2c_transfer(dev, &msg, 1, addr);
}

int
pmbus_rdblock(int addr, int command, int length, unsigned char *data)
{
	int i;
	
	unsigned char cmdbuf[1] = {command};
	unsigned char rdbuf[130];
	unsigned char crc;

	struct i2c_msg msg[2];
	const struct device *dev;


	dev = device_get_binding(i2c_dev);
	if (!dev) {
		printk("I2C: Device driver %s not found.", i2c_dev);
		return -ENODEV;
	}

//	const unsigned char *sendbuf[2] = { cmdbuf, dummybuf };
//	const int tosend[2] = { 2, length + 2 };
//	int sent, recvd;

	if (length > 128)
		exit(1);

	msg[0].buf = cmdbuf;
	msg[0].len = 1;
	msg[0].flags = I2C_MSG_WRITE;

	memset(rdbuf, 0, sizeof(rdbuf));
	//rdbuf[0] = addr | 1;
	msg[1].buf = rdbuf;
	msg[1].len = length;
	msg[1].flags = I2C_MSG_RESTART | I2C_MSG_READ | I2C_MSG_STOP;

	for (i = 0; i < 2; i++) {
	    i2c_transfer(dev, &msg[i], 1, addr);
	}

	memcpy(data, rdbuf, length);
	printk("Data: 0x%02x 0x%02x 0x%02x 0x%02x\n",
		   data[0], data[1], data[2], data[3]);
}
#endif

/*
 * pm commands
 * pm help
 * pm seq [-w|-n [time]] <on|off>
 * pm status
 * pm volt
 * pm amps
 * pm temp
 */

static int
pmbus_help_cmd(const struct shell *sh, size_t argc, char **argv)
{
	printk("\nPower Sequencing Options\n");
	printk("pm seq [-w|-n [time]] <on|off>\n");
	//printk("-w - Wait for Key Input between stages\n");
	printk("-n SEC - Wait for N seconds between stages\n");
	printk("on|off - tune power on/off\n");
	printk("status - status of power management\n");
	printk("volt - read voltages\n");
	printk("amps - read current\n");
	printk("temp - read temperature\n");
	return 0;
}

static int
pmbus_status_cmd(const struct shell *sh, size_t argc, char **argv)
{
	printk("\nStatus\n");
	return 0;
}

int
set_vrails(int sense, int sleep, int wait)
{
	printk("\nsetting vrails %s\n", (sense==POWER_ON)?"on":"off");
	int i;
	if (sense == POWER_ON) {
		i = 0;
		while(i < NUM_RAILS) {
			vrail_on(i);
		    vrail_isgood(i);
			if (sleep > 0)
				k_sleep(K_MSEC(1000*sleep));
			else if (wait) {
				//printk("press key to continue: ");
				//c=console_getchar();
				//printk("BACK\n");
			}
			i++;
		}
	} else {
		// point to last one
		i = NUM_RAILS-1;
		while (i >= 0) {
			vrail_off(i);
			if (sleep > 0)
				k_sleep(K_MSEC(1000*sleep));
			else if (wait) {
				//printk("press key to continue: ");
				//c=console_getchar();
				//printk("BACK\n");
			}
			i--;
		}
	}
	return 0;
}

static int
pmbus_seq_cmd(const struct shell *sh, size_t argc, char **argv)
{
	int i;
	int n = -1;
	int wflg = 0;
	char *tmp = NULL;
	int val = -1;

	printk("\nPower Sequence\n");
	for (i = 1; i < argc; i++) {
		if (argv[i][0] == '-') {
			switch (argv[i][1]) {
			case 'w':
				wflg++;
				break;
			case 'n':
				n = atoi(argv[i+1]);
				if (n <- 0) {
					printk(" N must be > 0\n");
					return -1;
				}
				i++;
				break;
			default:
				printk("Bad option: %c\n", argv[i][1]);
				return -1;
			}
		} else {
			tmp = strdup(argv[i]);
			tmp = toLower(tmp);
			if (strcmp(tmp, "on") == 0) {
				val = POWER_ON;
			} else if (strcmp(tmp, "off") == 0) {
				val = POWER_OFF;
			} else {
				printk("Bad arg: %s\n", argv[i]);
				free(tmp);
				return -1;
			}
			free(tmp);
		}
	}
	//printk("w=%d, val=%d\n", wflg, val);
	//if (n > 0 )
	//	printk("Delay: %d\n", n);
	//	if (wflg)
	//		console_init();

	// For now ignore
	wflg = 0;
	set_vrails(val, n, wflg);

	return 0;
}
static int
pmbus_volt_cmd(const struct shell *sh, size_t argc, char **argv)
{
	int i;
	char *mod;
	
	
	printk("\nVoltage Rails: (* - PG signal present)\n");
	i = 0;
	while (i < NUM_RAILS) {
		if (vrail[i].type & GPIO_RD)
			mod = "V*";
		else
			mod = "V";
		printk("%20s: %.4f%s\n", vrail[i].signame, vrail_rdvolt(i), mod);
		i++;
	}

	return 0;
}

static int trails[] = {VDD_2R5, VDD_0R9, VDD_1R2_DDR, -1};
static int
pmbus_temp_cmd(const struct shell *sh, size_t argc, char **argv)
{
	int i;
	
	printk("\nTemperature:\n");
	i = 0;
	while (trails[i] != -1) {
		printk("%20s: %.4fC\n", vrail[trails[i]].signame, pmbus_get_temp(trails[i]));
		i++;
	}

	return 0;
}

static int irails[] = {VDD_0R85, VDD_1R8, VDD_1R2_DDR, VDD_2R5, VDD_1R2_MGT, VDD_0R9, VDD_1R0, -1};
static int
pmbus_amps_cmd(const struct shell *sh, size_t argc, char **argv)
{
	int i;
	
	printk("\nCurrent:\n");
	i = 0;
	while (irails[i] != -1) {
		printk("%20s: %.4fA\n", vrail[irails[i]].signame, pmbus_get_iout(irails[i]));
		i++;
	}

	return 0;
}

SHELL_SUBCMD_SET_CREATE(sub_pmbus, (pm));
SHELL_SUBCMD_ADD((pm), help, NULL, "Help for pmbus commands", pmbus_help_cmd, 1, 0);
SHELL_SUBCMD_ADD((pm), seq, NULL, "Power Sequencing", pmbus_seq_cmd, 2, 2);
SHELL_SUBCMD_ADD((pm), status, NULL, "Status", pmbus_status_cmd, 1, 1);
SHELL_SUBCMD_ADD((pm), volt, NULL, "Read Voltages", pmbus_volt_cmd, 1, 1);
SHELL_SUBCMD_ADD((pm), amps, NULL, "Read Current", pmbus_amps_cmd, 1, 1);
SHELL_SUBCMD_ADD((pm), temp, NULL, "Read Temperatures", pmbus_temp_cmd, 1, 1);

SHELL_CMD_REGISTER(pm, &sub_pmbus, "Power Functions", NULL);
```
