## CMakeLists.txt
```
# SPDX-License-Identifier: Apache-2.0

cmake_minimum_required(VERSION 3.20.0)
find_package(Zephyr REQUIRED HINTS $ENV{ZEPHYR_BASE})
project(getchar)

target_sources(app PRIVATE src/commands.c src/console.c src/shell.c src/lib.c src/i2c.c src/gpio.c src/boardctl.c src/pmbus.c src/pmbus_cmds.c src/vrails.c src/irps5401.c src/led.c src/history.c) 
```

## prj.conf
```kconfig
CONFIG_CONSOLE_SUBSYS=y
CONFIG_CONSOLE_GETCHAR=y
CONFIG_CONSOLE_GETCHAR_BUFSIZE=64
CONFIG_CONSOLE_PUTCHAR_BUFSIZE=512

CONFIG_I2C=y

#CONFIG_ASSERT=y
CONFIG_REBOOT=y
#CONFIG_HW_STACK_PROTECTION=y
#CONFIG_STACK_SENTINEL=y
#CONFIG_STACK_CANARIES=y

# Some command handlers require a large stack.
CONFIG_SYSTEM_WORKQUEUE_STACK_SIZE=2304
CONFIG_MAIN_STACK_SIZE=4096
#CONFIG_MAIN_STACK_SIZE=8192

# Ensure an MCUboot-compatible binary is generated.
CONFIG_BOOTLOADER_MCUBOOT=y

# Enable flash operations.
CONFIG_FLASH=y


#CONFIG_MINIMAL_LIBC_MALLOC_ARENA_SIZE=1024
CONFIG_NEWLIB_LIBC=y
#CONFIG_PRINTK=y


# Enable mcumgr.
CONFIG_MCUMGR=y

# Enable most core commands.
CONFIG_MCUMGR_CMD_IMG_MGMT=y
CONFIG_MCUMGR_CMD_OS_MGMT=y
CONFIG_MCUMGR_CMD_STAT_MGMT=y

# overlay-serial.conf
# Enable the serial mcumgr transport.
CONFIG_MCUMGR_SMP_UART=y
CONFIG_SERIAL=y
CONFIG_UART_LINE_CTRL=y

# overlay-serial.conf
# Enable the serial mcumgr transport.
CONFIG_MCUMGR_SMP_UART=y
```

## src/boardctl.c
```c
#include <stdlib.h>
#include <sys/byteorder.h>
#include <drivers/gpio.h>
#include "shell.h"


#include "lib.h"
#include "gpio.h"
#include "pmbus.h"

#include "vrails.h"

char *i2c_dev = 0;
static int gpios_inited = 0;

#define EN_0R85_NODE DT_ALIAS(en_0r85)
static const struct gpio_dt_spec en_0r85 = GPIO_DT_SPEC_GET_OR(EN_0R85_NODE, gpios, {0});
#define PG_0R85_NODE DT_ALIAS(pg_0r85)
static const struct gpio_dt_spec pg_0r85 = GPIO_DT_SPEC_GET_OR(PG_0R85_NODE, gpios, {0});

#define PG_1R8_NODE DT_ALIAS(pg_1r8)
static const struct gpio_dt_spec pg_1r8 = GPIO_DT_SPEC_GET_OR(PG_1R8_NODE, gpios, {0});

#define EN_3R3_NODE	DT_ALIAS(en_3r3)
static const struct gpio_dt_spec en_3r3 = GPIO_DT_SPEC_GET(EN_3R3_NODE, gpios);
#define PG_3R3_NODE DT_ALIAS(pg_3r3)
static const struct gpio_dt_spec pg_3r3 = GPIO_DT_SPEC_GET_OR(PG_3R3_NODE, gpios, {0});


#define EN_1R2_DDR_NODE DT_ALIAS(en_1r2_ddr)
static const struct gpio_dt_spec en_1r2_ddr = GPIO_DT_SPEC_GET_OR(EN_1R2_DDR_NODE, gpios, {0});
#define PG_1R2_DDR_NODE DT_ALIAS(pg_1r2_ddr)
static const struct gpio_dt_spec pg_1r2_ddr = GPIO_DT_SPEC_GET_OR(PG_1R2_DDR_NODE, gpios, {0});

#define EN_0R6_NODE DT_ALIAS(en_0r6)
static const struct gpio_dt_spec en_0r6 = GPIO_DT_SPEC_GET_OR(EN_0R6_NODE, gpios, {0});
#define PG_0R6_NODE DT_ALIAS(pg_0r6)
static const struct gpio_dt_spec pg_0r6 = GPIO_DT_SPEC_GET_OR(PG_0R6_NODE, gpios, {0});


#define PG_2R5_NODE DT_ALIAS(pg_2r5)
static const struct gpio_dt_spec pg_2r5 = GPIO_DT_SPEC_GET_OR(PG_2R5_NODE, gpios, {0});

#define EN_1R2_MGT_NODE DT_ALIAS(en_1r2_mgt)
static const struct gpio_dt_spec en_1r2_mgt = GPIO_DT_SPEC_GET_OR(EN_1R2_MGT_NODE, gpios, {0});
#define PG_1R2_MGT_NODE DT_ALIAS(pg_1r2_mgt)
static const struct gpio_dt_spec pg_1r2_mgt = GPIO_DT_SPEC_GET_OR(PG_1R2_MGT_NODE, gpios, {0});

#define PG_0R9_NODE DT_ALIAS(pg_0r9)
static const struct gpio_dt_spec pg_0r9 = GPIO_DT_SPEC_GET_OR(PG_0R9_NODE, gpios, {0});

#define PG_1R0_NODE DT_ALIAS(pg_1r0)
static const struct gpio_dt_spec pg_1r0 = GPIO_DT_SPEC_GET_OR(PG_1R0_NODE, gpios, {0});

#define ZYNQ_PS_POR_NODE DT_ALIAS(zynq_ps_por)
static const struct gpio_dt_spec zynq_por = GPIO_DT_SPEC_GET(ZYNQ_PS_POR_NODE, gpios);

#define ZYNQ_PS_SRST_NODE DT_ALIAS(zynq_ps_srst)
static const struct gpio_dt_spec zynq_srst = GPIO_DT_SPEC_GET(ZYNQ_PS_SRST_NODE, gpios);

#define ZYNQ_PS_PROG_NODE DT_ALIAS(zynq_ps_prog)
static const struct gpio_dt_spec zynq_prog = GPIO_DT_SPEC_GET(ZYNQ_PS_PROG_NODE, gpios);


#define QSFP_RESETL_NODE DT_ALIAS(qsfp_resetl)
// Remove when used
__attribute__ ((unused))
static const struct gpio_dt_spec qsfp_reset = GPIO_DT_SPEC_GET(QSFP_RESETL_NODE, gpios);

#define FPGA_PS_DONE_NODE DT_ALIAS(fpga_ps_done)
static const struct gpio_dt_spec fpga_ps_done = GPIO_DT_SPEC_GET(FPGA_PS_DONE_NODE, gpios);

#define ZYNQ_PS_INIT_NODE DT_ALIAS(zynq_ps_init)
static const struct gpio_dt_spec zynq_init = GPIO_DT_SPEC_GET(ZYNQ_PS_INIT_NODE, gpios);

#define ZYNQ_PS_DONE_B_NODE DT_ALIAS(zynq_ps_done_b)
static const struct gpio_dt_spec zynq_done_b = GPIO_DT_SPEC_GET(ZYNQ_PS_DONE_B_NODE, gpios);
/*
 * if func == DEV_REINIT, reinitialize to default
 */
void
setup_dev(int func)
{
	//printk("func = %d, i2c_dev = %d\n", func, (int) i2c_dev);
	if ((func == DEV_REINIT) && i2c_dev) {
		free(i2c_dev);
		i2c_dev = NULL;
	}
	if (!i2c_dev) {
		i2c_dev = strdup(DEF_BUS);
	}

	if (!gpios_inited) {
		gpios_inited = 1;
		//gpio_dump_regs(XGPIOA);

		gpio_pin_configure_dt(&en_0r85, GPIO_OUTPUT);
		gpio_pin_configure_dt(&pg_0r85, GPIO_INPUT);
		vrail[VDD_0R85].enable_node = &en_0r85;
		vrail[VDD_0R85].isgood_node = &pg_0r85;

		gpio_pin_configure_dt(&pg_1r8, GPIO_INPUT);
		vrail[VDD_1R8].isgood_node = &pg_1r8;

		gpio_pin_configure_dt(&en_3r3, GPIO_OUTPUT);
		gpio_pin_configure_dt(&pg_3r3, GPIO_INPUT);
		vrail[VDD_3R3].enable_node = &en_3r3;
		vrail[VDD_3R3].isgood_node = &pg_3r3;
		
		gpio_pin_configure_dt(&en_1r2_ddr, GPIO_OUTPUT);
		gpio_pin_configure_dt(&pg_1r2_ddr, GPIO_INPUT);
		vrail[VDD_1R2_DDR].enable_node = &en_1r2_ddr;
		vrail[VDD_1R2_DDR].isgood_node = &pg_1r2_ddr;

		gpio_pin_configure_dt(&en_0r6, GPIO_OUTPUT);
		gpio_pin_configure_dt(&pg_0r6, GPIO_INPUT);
		vrail[VDD_0R6].enable_node = &en_0r6;
		vrail[VDD_0R6].isgood_node = &pg_0r6;

		gpio_pin_configure_dt(&pg_2r5, GPIO_INPUT);
		vrail[VDD_2R5].isgood_node = &pg_2r5;
		
		gpio_pin_configure_dt(&en_1r2_mgt, GPIO_OUTPUT);	
		gpio_pin_configure_dt(&pg_1r2_mgt, GPIO_INPUT);
		vrail[VDD_1R2_MGT].enable_node = &en_1r2_mgt;
		vrail[VDD_1R2_MGT].isgood_node = &pg_1r2_mgt;

		
		gpio_pin_configure_dt(&pg_0r9, GPIO_INPUT);
		vrail[VDD_0R9].isgood_node = &pg_0r9;

		gpio_pin_configure_dt(&pg_1r0, GPIO_INPUT);
		vrail[VDD_1R0].isgood_node = &pg_1r0;

		gpio_pin_configure_dt(&zynq_srst, GPIO_OUTPUT);
		gpio_pin_configure_dt(&zynq_por, GPIO_OUTPUT);
		gpio_pin_configure_dt(&zynq_prog, GPIO_OUTPUT);
		gpio_pin_configure_dt(&fpga_ps_done, GPIO_OUTPUT);

		gpio_pin_configure_dt(&zynq_init, GPIO_INPUT);
		gpio_pin_configure_dt(&zynq_done_b, GPIO_INPUT);

//gpio_dump_regs(XGPIOA);
		//gpio_dump_regs(XGPIOB);
		//gpio_dump_regs(XGPIOC);

	}
}

/*
 * Sundar email - 1/10/23
 * deassert zynq_ps_prog (set PC1 to '0'')
 * deassert zynq_ps_srst (set PC3 to '0')
 * assert zynq_ps_por (set PC4 to '1')
 * After power is up.
 * deassert zynq_ps_por (set PC3 to '0')
 */
void
start_cpu()
{
	//printf("done_b: %d\n", get_ps_stat(GET_DONE_B));
	gpio_pin_set_dt(&zynq_prog, 0);
	//printf("done_b: %d\n", get_ps_stat(GET_DONE_B));
	gpio_pin_set_dt(&zynq_srst, 0);
	//printf("done_b: %d\n", get_ps_stat(GET_DONE_B));
	gpio_pin_set_dt(&zynq_por, 1);
	//printk("setting prog=0, stst=0, por=1\n");

	printf("\npre power: done_b: %d\n", get_ps_stat(GET_DONE_B));
	set_vrails(POWER_ON, 0, 0);
	printf("\npost power done_b: %d\n", get_ps_stat(GET_DONE_B));

	int delay = 11;
	//printk("Delay %d mSec\n", delay);
	k_sleep(K_MSEC(delay));

	//printf("done_b: %d\n", get_ps_stat(GET_DONE_B));
	gpio_pin_set_dt(&zynq_por, 0);
	//printk("setting por=0\n");
	printf("\nafter POR=0, done_b: %d\n", get_ps_stat(GET_DONE_B));

	printf("set to 0\n");
	set_ps_bit(SET_FPGA_PSD, 0);

#if 0
	printf("set to 0\n");
	set_ps_bit(SET_FPGA_PSD, 0);
	printf("read back %d\n", get_ps_stat(GET_FPGA_PSD));
	
	printf("set to 1\n");
	set_ps_bit(SET_FPGA_PSD, 1);
	printf("read back %d\n", get_ps_stat(GET_FPGA_PSD));
#endif
}

struct pin {
	char *name;		/* name */
	int cval;		/* current value */
	int	func;		/* SET_POR, etc */
};
struct pin pintab[] = {
	{"srst", 0, SET_SRST},
	{"por", 0, SET_POR},
	{"prog", 0, SET_PROG},
	{"fpga_psd", 0, SET_FPGA_PSD},
	{"all", 0, SET_ALL},
	{NULL, 0, 0}
};

void
set_ps_bit(int line, int val)
{
	switch(line) {
	case SET_POR:
		gpio_pin_set_dt(&zynq_por, val);
		break;
	case SET_SRST:
		gpio_pin_set_dt(&zynq_srst, val);
		break;
	case SET_PROG:
		gpio_pin_set_dt(&zynq_prog, val);
		break;
	case SET_FPGA_PSD:
		printf("\nset fpga to %d\n", val);
		gpio_pin_set_dt(&fpga_ps_done, val);
		break;
	case SET_ALL:
		gpio_pin_set_dt(&zynq_srst, val);
		gpio_pin_set_dt(&zynq_por, val);
		gpio_pin_set_dt(&zynq_prog, val);
		gpio_pin_set_dt(&fpga_ps_done, val);
		break;
	default:
		printf("bad line...\n");
		return;
	}
	if (line == SET_ALL) {
		int i2;
		for (i2 = 0; pintab[i2].func != SET_ALL; i2++) {
			pintab[i2].cval = val;
		}
	} else {
		pintab[line].cval = val;
	}
}

int get_ps_stat(int line)
{
	switch(line) {
	case GET_DONE_B:
		return gpio_pin_get_dt(&zynq_done_b);
	case GET_INIT:
		return gpio_pin_get_dt(&zynq_init);
	case GET_FPGA_PSD:
		return pintab[SET_FPGA_PSD].cval;
	}
	printf("OOPS!!!\n");
	return 0xdeadbeef;
}

int
io_set(int argc, char **argv)
{
	int i;
	if (argc == 1) {
		printf("\n");
		for (i = 0; pintab[i].func != SET_ALL; i++)
			printf("%s: %d\n", pintab[i].name, pintab[i].cval);
		return 0;
	}

	if (argc != 3) {
		printf("usage set <LINE> <VALUE>\n");
		return -1;
	}
	char *line = toLower(argv[1]);
	int val = atoi(argv[2]);

	if ((val < 0) || (val > 1)) {
		printf("val must be 1 or 0\n");
		return -1;
	}

	int match = 0;
	for (i = 0; pintab[i].name; i++) {
		if (strcmp(line, pintab[i].name) == 0) {
			set_ps_bit(pintab[i].func, val);
#if 0			
			if (pintab[i].func == SET_ALL) {
				int i2;
				for (i2 = 0; pintab[i2].func != SET_ALL; i2++) {
					pintab[i2].cval = val;
				}
			} else {
				pintab[i].cval = val;
			}
#endif
			match++;
		}
	}
	if (match)
		return 0;

	printf("line must one of: ");
	for (i = 0; pintab[i].name; i++) {
		printf("%s ", pintab[i].name);
	}
	printf("\n");
	return -1;
}

struct pin status[] = {
	{"done_b", 0, GET_DONE_B},
	{"init", 0, GET_INIT},
	{"fpga_ps_done", 0, GET_FPGA_PSD},
	{NULL, 0, 0}
};

int
io_get(int argc, char **argv)
{
	int i;

	if (argc == 1) {
		printf("\n");
		for (i = 0; status[i].name; i++)
			printf("%s: %d\n", status[i].name, get_ps_stat(status[i].func));
		return 0;
	}
	if (argc != 2) {
		printf("usage get <LINE>\n");
		return -1;
	}

	char *line = toLower(argv[1]);
	int match = 0;
	for (i = 0; status[i].name; i++) {
		if (strcmp(line, status[i].name) == 0) {
			printf("\n%s: %d\n", status[i].name, get_ps_stat(status[i].func));
			match++;
		}
	}
	if (match)
		return 0;
	printf("line must be one of: " );
	for (i = 0; status[i].name; i++) {
		printf("%s ", status[i].name);
	}
	printf("\n");
	return -1;
}


static struct command_table io_tab[] = {
	{"get", io_get, "read IO pin values"},
	{"set", io_set, "set IO pin values"},
	{0}
};

int
io_cmd(int argc, char **argv)
{
	int i;
	char *p = NULL;

#if 0
	printf("running IO submenu...argc = %d\n", argc);
	for ( i = 0; i < argc; i++) {
		printf("arg[%d]: %s\n", i, argv[i]);
	}
#endif
	if (argc > 1) {
		p = malloc(256);
		*p = '\0';
		for (i = 1; i < argc; i++) {
			strcat(p, argv[i]);
			strcat(p, " ");
		}
	} else {
	}
	runcmdlist(io_tab, "io", "IO> ", 1, p);
	if (p)
		free(p);

	//printf("Back...\n");
	return 0;
}
```

## src/commands.c
```c
#include "shell.h"
#ifndef EMUL
#include <zephyr/sys/reboot.h>
#include <sys_clock.h>
#endif

#include "lib.h"

unsigned int
get_kuptime()
{
#ifdef EMUL
	return (unsigned int)1000;
#else
	return k_uptime_get_32();
#endif
}

int uptime_cmd(int argc, char **argv)
{
	printf("Uptime: %u ms\n", get_kuptime());
	return 0;
}

int cycles_cmd(int argc, char **argv)
{
#ifdef EMUL
	printf("cycles: 1000 hw cycles\n");
#else
	printf("cycles: %u hw cycles\n", k_cycle_get_32());
#endif
	return 0;
}

int
reboot_cmd(int argc, char **argv)
{
	printf("Rebooting.....\n\n\n");
#ifndef EMUL
	k_sleep(K_MSEC(100));
	sys_reboot(SYS_REBOOT_COLD);
#endif
	return 0;
}

static struct command_table kern_tab[] = {
	{"uptime", uptime_cmd, "System uptime"},
	{"reboot", reboot_cmd, "Reboot system"},
	{"cycles", cycles_cmd, "HW cycles"},
	{0}
};

int loopcnt;
int loopnum;
/*
 * echo args
 * special args
 *	%P%	- current pass in a loop
 *  %L% - loop count in a loop
 *  %U% - uptime in ms
*/
int
echo_cmd(int argc, char **argv)
{
	int i;
	char *s;
	for ( i = 1; i < argc; i++) {
		s = argv[i];
		if (strcmp(s, "%P%") == 0)
			printf("%d ", loopnum);
		else if (strcmp(s, "%L%") == 0)
			printf("%d ", loopcnt);
		else if (strcmp(s, "%U%") == 0)
			printf("%u ", get_kuptime());
		else
			printf("%s ", argv[i]);
	}
	printf("\n");
	return 0;
}
int
sleep_cmd(int argc, char **argv)
{
	int sval;
#if 0
	int i;
	printf("run sleep cmd...argc = %d\n", argc);
	for ( i = 0; i < argc; i++) {
		printf("arg[%d]: %s\n", i, argv[i]);
	}
#endif
	if (argc != 2) {
		printf("sleep [NSEC].\n");fflush(stdout);
		return -1;
	}

	sval = atoi(argv[1]);
#ifdef EMUL
	printf("Sleeping for %d seconds\n", sval);
#else
	k_sleep(K_MSEC(sval*1000));
	printf("\n");
#endif
	return 0;
}

/*
 * loop [LABEL] [COUNT]
 */
extern struct command_table cmd_tab[];
int
loop_cmd(int argc, char **argv)
{
	int idx, i, i2;
	int ac;
	char *av[MAXARGS];
	char *tcmd;
	struct command_table *c;
	
	extern struct history hist_tab[];
	
	if (argc != 3) {
		printf("loop <label> <count>\n");
		return -1;
	}
	idx = hist_getlabel(argv[1]);
#if 0
	{
		int z;
		printf("idx = %d\n", idx);
		for (z=0; z < NHIST; z++) {
			if (hist_tab[z].cmd)
				printf("[%d] - %d: %s\n", z, hist_tab[z].hnum, hist_tab[z].cmd);
			else
				printf("[%d]: NULL\n", z);
		}
	}
#endif			
	//  Global loopcnt for echo
	loopcnt = atoi(argv[2]);

	// printf("Looping %d times\n", loopcnt);
	
	for (i2 = 0; i2 < loopcnt; i2++) {
		//printf("Pass: %d\n", i2);
		loopnum = i2;	// global pass no for echo
		for (i = idx+1; i < (NHIST-1); i++) {
			//printf("run: %s\n", hist_tab[i].cmd);
			tcmd = strdup(hist_tab[i].cmd);
			ac = buildargs(tcmd, av);
			//printf("a0 = %s\n", av[0]);
			if (strcmp(tcmd, "loop") == 0 ) {
				free(tcmd);
				break;
			}
			free(tcmd);
			//printf("a0.0 = %s\n", av[0]);
			for (c = &cmd_tab[0]; c->func; c++) {
				//printf("cmd: %s\n", c->name);
				if (strncmp(av[0], c->name, 2) == 0) {
					(*c->func)(ac, av);
					break;
				}
			}
		}
	}
	
	return 0;
}

int
kern_cmd(int argc, char **argv)
{
	int i;
	char *p = NULL;

#if 0
	printf("run kernel submenu...argc = %d\n", argc);
	for ( i = 0; i < argc; i++) {
		printf("arg[%d]: %s\n", i, argv[i]);
	}
#endif
	if (argc > 1) {
		p = malloc(256);
		*p = '\0';
		for (i = 1; i < argc; i++) {
			strcat(p, argv[i]);
			strcat(p, " ");
		}
	} else {
	}
	runcmdlist(kern_tab, "kernel", "Kernel> ", 1, p);
	if (p)
		free(p);

	//printf("Back...\n");
	return 0;
}

int
vers_cmd(int argc, char **argv)
{
	printf("Version %s\n", KERNEL_VERSION_STRING);
	return 0;
}

#ifdef EMUL
void
setup_dev(int f)
{
	printf("Setupdev: %d\n", f);
}

void
start_cpu()
{
}

i2c_scan(int argc, char **argv)
{
	int i;
	printf("--------running i2c scan...argc = %d\n", argc);
	for ( i = 0; i < argc; i++) {
		printf("arg[%d]: %s\n", i, argv[i]);
	}
}
	
i2c_set_mux(int argc, char **argv)
{
	int i;
	printf("run i2c set_mux...argc = %d\n", argc);
	for ( i = 0; i < argc; i++) {
		printf("arg[%d]: %s\n", i, argv[i]);
	}
}
i2c_set_bus(int argc, char **argv)
{
	int i;
	printf("run i2c set_bus...argc = %d\n", argc);
	for ( i = 0; i < argc; i++) {
		printf("arg[%d]: %s\n", i, argv[i]);
	}
}
static struct command_table i2c_tab[] = {
	{"scan", i2c_scan, "scan i2c bus"},
	{"mux", i2c_set_mux, "set i2c mux address"},
	{"bus", i2c_set_bus, "set i2c bus (I2C_1, etc)"},
	{0}
};

int
i2c_cmd(int argc, char **argv)
{
	int i;
	char *p = NULL;

#if 1
	printf("running i2c submenu...argc = %d\n", argc);
	for ( i = 0; i < argc; i++) {
		printf("arg[%d]: %s\n", i, argv[i]);
	}
#endif
	if (argc > 1) {
		p = malloc(256);
		*p = '\0';
		for (i = 1; i < argc; i++) {
			strcat(p, argv[i]);
			strcat(p, " ");
		}
	} else {
	}
	runcmdlist(i2c_tab, "i2c", "I2C> ", 1, p);
	if (p)
		free(p);

	//printf("Back...\n");
	return 0;
}
	
int
led_cmd(int argc, char **argv)
{
	int i;
	printf("run led submenu...argc = %d\n", argc);
	for ( i = 0; i < argc; i++) {
		printf("arg[%d]: %s\n", i, argv[i]);
	}
	return 0;
}
int
pmbus_cmd(int argc, char **argv)
{
	int i;
	printf("run pmbus submenu...argc = %d\n", argc);
	for ( i = 0; i < argc; i++) {
		printf("arg[%d]: %s\n", i, argv[i]);
	}
	return 0;
}
#endif
```

## src/console.c
```c
#include "shell.h"
#include "console.h"

#ifdef EMUL
#include <termios.h>

static struct termios old, new1;

void
initterm(int echo) {
    tcgetattr(0, &old); /* grab old terminal i/o settings */
    new1 = old; /* make new settings same as old settings */
    new1.c_lflag &= ~ICANON; /* disable buffered i/o */
    new1.c_lflag &= echo ? ECHO : ~ECHO; /* set echo mode */
    tcsetattr(0, TCSANOW, &new1); /* use these new terminal i/o settings now */
}

/* Restore old terminal i/o settings */
void resetterm(void) {
    tcsetattr(0, TCSANOW, &old);
}
#endif

static int isinited = 0;
void init_uart()
{
#ifdef EMUL
	// set raw mode
	initterm(0);
#else
	console_init();
#endif /* EMUL */
	isinited = 1;
}

int getch()
{
	if (!isinited) {
		init_uart();
	}
	
#ifdef EMUL
	char ch = fgetc(stdin);
	if (ch == EOF)
		return '\n';
	return ch;
#else
	char c;
	c = console_getchar();

	if (c == '\r') {
		c = '\n';
	}
	return c;
#endif
}

void putch(int c)
{
	if (!isinited) {
		init_uart();
	}
	
#ifdef EMUL
	putc(c, stdout);
	fflush(stdout);
#else
	/* if (c == 0x0a) { */
	/* 	console_putchar('+'); */
	/* 	console_putchar(0x0d); */
	/* 	console_putchar('-'); */
	/* 	console_putchar(0x0a); */
	/* 	console_putchar('!'); */
	/* } else */
	console_putchar(c);
#endif
}

int
puts(const char *s)
{
	char *p = (char *)s;
	while(*p) {
		putch(*p++);
	}
	return 0;
}

int
zgetline(char **ptr, char *prompt)
{
	if (!isinited) {
		init_uart();
	}
	
	char * line = malloc(100), * linep = line;
    size_t lenmax = 100, len = lenmax;
    int c, c1, c2, c3;
	int rval = GLSTR;		// are we processing ansii sequence??

	//printf("Entering zgetline: ");
    if (line == NULL)
        return GLERR;

    for(;;) {
        c = getch();
        if(c == '\n') {
			putch('\n');
			putch('\r');
            break;
		}
		//printf("\n(%x)-\n", c);
#if 1
 		if (c == ESC) {
			c1 = getch();
			//printf("\n-c1=%c (%x)-\n", c1, c1);
			if (c1 == ESC1) {	// c1 == '['
				c2 = getch();
				//printf("\n-c2=%c (%x)-\n", c2, c2);
				if (c2 < 0x40) {	// c2 < 40, do 4 char escape.
					c3 = getch();
					//printf("\n-c3=%c (%x)-\n", c3, c3);
					if (c3 == END4) {
						// Good 4 byte escape code
						line[0] = c2;
						line[1] = '\0';
						rval = GLESCODE;
					} else {
						line[0] = '\0';
						rval = GLERR;
					}
				} else {	// >= 40, 3 code escape
					line[0] = c2;
					line[1] = '\0';
					rval = GLESCODE;
				}
			} else {
				line[0] = '\0';
				rval = GLERR;
			}
			if (line[0] == PREVH) {
				int tlen;
				char *p = prevhist();
				if (!p) {
					continue;
				}
				strcpy(linep, p);
				tlen = strlen(linep);
				line = linep+tlen;
				len = lenmax - tlen;
				printf("                                \r");
				printf("%s%s", prompt, linep);
				fflush(stdout);
				rval = GLHIST;
					  
			} else if (line[0] == NEXTH) {
				int tlen;
				char *p = nexthist();
				if (!p) {
					continue;
				}
				strcpy(linep, p);
				tlen = strlen(linep);
				line = linep+tlen;
				len = lenmax - tlen;
				printf("                                \r");
				printf("%s%s", prompt, linep);
				fflush(stdout);
				rval = GLHIST;
			} else {
				*ptr = linep;
				return rval;
			}
			continue;
		}
#endif
		if ((c == BS) || (c == CTLH)) {
			// change from possible GLHIST since command was changed
			// want to add to history...
			rval = GLSTR;
			//printf("ERASE\n");
			// Dont try to erase before line starts!
			if (line > linep) {
				*--line = '\0';
				len++;
				putch(0x8);
				putch(' ');
				putch(0x8);
			}
			continue;
		}
					
		//printf("c=0x%x (%c)\n", c, c);
		putch(c);
		  

        if(--len == 0) {
            len = lenmax;
            char * linen = realloc(linep, lenmax *= 2);

            if(linen == NULL) {
                free(linep);
                return GLERR;
            }
            line = linen + (line - linep);
            linep = linen;
        }

#if 0
        if((*line++ = c) == '\n') {
			printf("returning...\n");
				   
            break;
		}
#else
		*line++ = c;
		// change from possible GLHIST since command was changed
		// want to add to history...
		rval = GLSTR;
#endif

    }
    *line = '\0';
	*ptr = linep;
	if (strlen(*ptr) == 0) {
		return GLEOF;
	}
    return rval;
}
```

## src/console.h
```c
#ifndef EMUL
#include <zephyr/zephyr.h>
#include <zephyr/sys/printk.h>
#include <zephyr/console/console.h>
//#define fflush(x)	;
#endif


extern int getch();
extern void putch(int);
extern int puts(const char *);

#define ESC		0x1b
#define ESC1	0x5b	// '['
// 3 char codes 'esc[X'
#define UPARROW	0x41	// 'A'
#define DNARROW 0x42    // 'B'
#define RARROW	0x43	// 'C'
#define LARROW	0x44	// 'D'
#define END		0x46	// 'F'
#define HOME	0x48	// 'H'

// 4 char codes 'esc[C~'
#define INS		0x32	// '2'
#define DEL		0x33	// '3'
#define PGUP	0x35	// '5'
#define PGDN	0x36	// '6'

#define	END4	0x7e	// '~'

#define BS		0x7f
#define CTLH	0x8

// zGLine return codes...
#define GLSTR		0x1
#define GLESCODE	0x2
#define GLEOF		0x3	// empty line...
#define GLHIST		0x4 // history command
#define GLERR		-1
```

## src/history.c
```c
#include "shell.h"

struct history hist_tab[NHIST] = {0};

static int hnum = 0;			// ever increasing history number
static int currhist = NHIST-1;	// for get prev/next histor

void
add2hist(char *l)
{
	int i;
#if 0
	printf("\nadd2hist: %s:\n", l);
	printf("caller name %pS\n", __builtin_return_address(0));
	{
		for (i=0; i < NHIST; i++) {
			if (hist_tab[i].cmd == NULL)
				printf("%d: %d: NULL\n", i, hist_tab[i].hnum);
			else
				printf("%d: %d: %s\n", i, hist_tab[i].hnum, hist_tab[i].cmd);
		}
	}
#endif
	if (hist_tab[0].cmd) {
		// printf("Freeing (%s) %p\n", hist_tab[0].cmd, hist_tab[0].cmd);
		free(hist_tab[0].cmd);
	}
	for ( i = 0; i < (NHIST-1); i++) {
		hist_tab[i].cmd = hist_tab[i+1].cmd;
		hist_tab[i].hnum = hist_tab[i+1].hnum;
	}
	hist_tab[NHIST-1].cmd = l;
	hist_tab[NHIST-1].hnum = ++hnum;
	currhist = NHIST-1;
#if 0
	{
		printf("Added %d: %s in slot %d\n", hist_tab[NHIST-1].hnum, l, NHIST-1);
	}
#endif
}

/*
 * look for label in history, return offset if present, else -1
 */
int
hist_getlabel(char *s)
{
	int i;
	int tlen;
	char *tmp;
	
	for (i = 0; i < (NHIST-1); i++) {
		tmp = hist_tab[i].cmd;
		if (tmp) {
			tlen = strlen(tmp);
			//printf("tmp=%s, len:%d\n", tmp, tlen);
			if (strncmp(tmp, s, tlen-1) == 0) {
				if (tmp[tlen-1] == ':') {
					return i;
				}
			} 
		}
	}
	return -1;
}

int
hist_cmd(int arc, char **argv)
{
	int i;

	for (i=0; i < NHIST; i++) {
#ifdef DEBUG 
		if (hist_tab[i].cmd)
			printf("hist[%d]: %d - %s\n", i, hist_tab[i].hnum, hist_tab[i].cmd);
		else
			printf("hist[%d]: %d - %p\n", i, hist_tab[i].hnum, hist_tab[i].cmd);
#else
		if (hist_tab[i].cmd)
			printf("%d: %s\n", hist_tab[i].hnum, hist_tab[i].cmd);
#endif
	}
	return 0;
}

char *
prevhist()
{
	struct history *h = &hist_tab[currhist];

	if (h->cmd) {
		// printf("%d: %s\n", h->hnum, h->cmd);
		if ( (h-1)->cmd) {
			currhist--;
		}
		return(h->cmd);
	}
	return NULL;
}
		
char *
nexthist()
{
	struct history *h = &hist_tab[currhist];

	if ( (h+1)->cmd) {
		currhist++;
		h++;
	}
	if (h->cmd) {
		// printf("%d: %s\n", h->hnum, h->cmd);
		return(h->cmd);
	}
	return NULL;
}

void resethist()
{
	currhist = NHIST-1;
}
```

## src/i2c.c
```c
/*
 * Copyright (c) 2018 Nordic Semiconductor ASA
 *
 * SPDX-License-Identifier: Apache-2.0
 */

#include <stdlib.h>
#include <zephyr/logging/log.h>
#include <zephyr/drivers/i2c.h>
#include <zephyr/shell/shell.h>
#include <drivers/gpio.h>
#include <sys/byteorder.h>

#include "i2c.h"
#include "lib.h"
#include "gpio.h"
#include "shell.h"
static int get_bytes_count_for_hex(int);

LOG_MODULE_REGISTER(app_test);

#define MAX_BYTES_FOR_REGISTER_INDEX	4
#define MAX_I2C_BYTES	16




static int i2c_addresses[] = {
	[QSFP_BUS] = QSFP_ADDR,
	[EEP_BUS] = EEP_ADDR,
	[IRPS_BUS] = IRPS_ADDR,
	[MAX_BUS] = MAX_ADDR,
	[EEPROM_BUS] = EEPROM_ADDR,
	[LED_BUS] = LED_ADDR
};

/* #define LED0_NODE	DT_ALIAS(led0) */
/* static const struct gpio_dt_spec led = GPIO_DT_SPEC_GET(LED0_NODE, gpios); */

#define RST_NODE	DT_ALIAS(rstmux)
static const struct gpio_dt_spec resetmux = GPIO_DT_SPEC_GET(RST_NODE, gpios);

int
reset_mux()
{
	int rval;

	if (!device_is_ready(resetmux.port)) {
		printf("Not ready mux\n");
		return -ENODEV;
	}
	rval = gpio_pin_configure_dt(&resetmux, GPIO_OUTPUT_ACTIVE);
	if (rval < 0) {
		printf("MUX config error: %d\n", rval);
		return -EIO;
	}

	// set type to open-drain
	gpio_set1(XGPIOB, GPIO_OTYPER, 0x20);
	// High Speed
	gpio_set1(XGPIOB, GPIO_SPEEDR, 0xc00);
	gpio_pin_set_dt(&resetmux, 0);
	k_msleep(10);
	gpio_pin_set_dt(&resetmux, 1);

	return 0;
}

static int current_mux = -1;
int
set_mux(int busid)
{
	int rval;
	char buf[20];
	
	// only write if different.
	if (current_mux == busid)
		return 0;
	
	if ((rval=reset_mux()) < 0)
		return rval;

	if ( (busid<0) > (busid>7) ) {
		printf("Bad BusID: %d\n", busid);
		return -1;
	}
	// printf("SetMux to %d\n", busid);
	buf[0] = 1<<busid;
	current_mux = busid;
	//printf("reset ok, setting bus to %d.\n", busid);
	i2c_write_bytes(0x74, 0, buf, 1);

	return 0;
}

int
get_mux()
{
	return current_mux;
}

int get_i2c_addr(int chip)
{
	if (chip > LAST_BUS)
		return -1;
	return i2c_addresses[chip];
}

int
i2c_scan(int argc, char **argv)
{
	const struct device *d;
	uint8_t cnt = 0, first = 0x04, last = 0x77;

	d = device_get_binding(i2c_dev);

	if (!d) {
		printf("I2C: Device driver %s not found.", i2c_dev);
		return -ENODEV;
	}
	printf("I2C Bus: %d\n", get_mux());
	printf("     0  1  2  3  4  5  6  7  8  9  a  b  c  d  e  f\n");
	for (uint8_t i = 0; i <= last; i += 16) {
		printf("%02x: ", i);
		for (uint8_t j = 0; j < 16; j++) {
			if (i + j < first || i + j > last) {
				printf("   ");
				continue;
			}

			struct i2c_msg msgs[1];
			uint8_t dst;

			/* Send the address to read from */
			msgs[0].buf = &dst;
			msgs[0].len = 0U;
			msgs[0].flags = I2C_MSG_WRITE | I2C_MSG_STOP;
			if (i2c_transfer(d, &msgs[0], 1, i + j) == 0) {
				printf("%02x ", i + j);
				++cnt;
			} else {
				printf("-- ");
			}
		}
		printf("\n");
		}

	printf("%u devices found on %s\n", cnt, i2c_dev);
	return 0;
}

/* 
 * set I2C_BUS_NUMBER (0-5)
 */
int
i2c_set_mux(int argc, char **argv)
{
	int bus;

	//printk("Before setup\n");
	//gpio_dump_regs(XGPIOB);
	if (argc < 2) {
		printf("Current mux value: %d\n", get_mux());
		return 0;
	}

 	bus = atoi(argv[1]);

	if ( (bus < 0) || (bus > 5)) {
		printf("BUS: %d, error: 0 <= BUSNUM <= 5", bus);
		return -ENODEV;
	}
	//print("set executed, bus=%d", bus);
	set_mux(bus);
	return 0;
}
/* 
 * DEV I2C_BUS_NAME (I2C_1, etc)
 */
int
i2c_set_bus(int argc, char **argv)
{

/*	
	printf("i2c_dev = %d\n", (int) i2c_dev);
	printd("arg[1] = %s\n", argv[1]);
*/
	if (argc == 1) {
		if (!i2c_dev) {
			printf("Current bus unset\n");
		} else {
			printf("Current bus: %s\n", i2c_dev);
		}
		return 0;
	}
	
	if (strcmp("-r", argv[1]) == 0) {
		setup_dev(DEV_REINIT);
		printf("I2C bus reset to %s\n", DEF_BUS);
		return 0;
	}
			

	if (i2c_dev != (char *)NULL) {
		free(i2c_dev);
	}
		
	i2c_dev = malloc(strlen(argv[1])+1);
	strcpy(i2c_dev, argv[1]);
	printf("I2c Bus changed to %s\n", i2c_dev);

	return 0;
}

int
i2c_read_bytes(int dev_addr, int reg_addr, char *obuf, int olen)
{
	uint8_t reg_addr_buf[MAX_BYTES_FOR_REGISTER_INDEX];
	int reg_addr_bytes;
	const struct device *dev;
	int ret;

	dev = device_get_binding(i2c_dev);
	if (!dev) {
		printk("I2C: Device driver %s not found.", i2c_dev);
		return -ENODEV;
	}
	reg_addr_bytes = get_bytes_count_for_hex(reg_addr);
	sys_put_be32(reg_addr, reg_addr_buf);


	ret = i2c_write_read(dev, dev_addr,
			     reg_addr_buf +
			       MAX_BYTES_FOR_REGISTER_INDEX - reg_addr_bytes,
			     reg_addr_bytes, obuf, olen);
	if (ret < 0) {
		printk("Failed to read from device: 0x%02x", dev_addr);
		return -EIO;
	}
#if 0
	printk("i2c_write_read: 0x%02x  0x%02x  0x%02x  0x%02x\n",
		   obuf[0], obuf[1], obuf[2], obuf[3]);
#endif
	return 0;
}

int
i2c_write_bytes(int dev_addr, int reg_addr, char *ibuf, int ilen)
{
	int ret;
	/* [ 16 + 4 - 1 ] */
	uint8_t buf[MAX_I2C_BYTES + MAX_BYTES_FOR_REGISTER_INDEX - 1];
	const struct device *dev;
	int reg_addr_bytes;

	dev = device_get_binding(i2c_dev);
	if (!dev) {
		printk("I2C: Device driver %s not found.", i2c_dev);
		return -ENODEV;
	}
	reg_addr_bytes = get_bytes_count_for_hex(reg_addr);
	//printk("Write to addr: 0x%x\n", dev_addr);
	//printk("Write to reg:  0x%x\n", reg_addr);

	sys_put_be32(reg_addr, buf);

	
	int i;
	for (i = 0; i < ilen; i++) {
		buf[MAX_BYTES_FOR_REGISTER_INDEX + i] = ibuf[i];
	}

#if 0
	for (i=0; i<8; i++) {
		printk("0x%02x ", buf[i]);
	}
	printk("\n");
#endif
	/* len is 2, 1 for register size, 1 for our data */
	ret = i2c_write(dev,
					buf + MAX_BYTES_FOR_REGISTER_INDEX - reg_addr_bytes,
					ilen+reg_addr_bytes, dev_addr);

	return 0;
}

static
int get_bytes_count_for_hex(int val)
{
	char arg[10];
	itoa(val, arg, 16);

	//printk("%d number is string %s\n", val, arg);
	int length = (strlen(arg) + 1) / 2;

	if (length > 1 && arg[0] == '0' && (arg[1] == 'x' || arg[1] == 'X')) {
		length -= 1;
	}

	return MIN(MAX_BYTES_FOR_REGISTER_INDEX, length);
		
}

static struct command_table i2c_tab[] = {
	{"scan", i2c_scan, "scan i2c bus"},
	{"mux", i2c_set_mux, "set i2c mux address"},
	{"bus", i2c_set_bus, "set i2c bus (I2C_1, etc)"},
	{0}
};

int
i2c_cmd(int argc, char **argv)
{
	int i;
	char *p = NULL;

#if 0
	printf("run i2c submenu...argc = %d\n", argc);
	for ( i = 0; i < argc; i++) {
		printf("arg[%d]: %s\n", i, argv[i]);
	}
#endif
	if (argc > 1) {
		p = malloc(256);
		*p = '\0';
		for (i = 1; i < argc; i++) {
			strcat(p, argv[i]);
			strcat(p, " ");
		}
	} else {
	}
	runcmdlist(i2c_tab, "i2c", "I2C> ", 1, p);
	if (p)
		free(p);

	//printf("Back...\n");
	return 0;
}
```

## src/i2c.h
```c
#define QSFP_ADDR	0xFF	// Later...
#define EEP_ADDR	0xff	// also...
#define IRPS_ADDR	0x40
#define MAX_ADDR	0x54
#define EEPROM_ADDR	0x54
#define LED_ADDR	0x43

#define QSFP_BUS	0
#define EEP_BUS		1
#define IRPS_BUS	2
#define MAX_BUS		3
#define EEPROM_BUS	4
#define LED_BUS		5
#define LAST_BUS	LED_BUS

extern int get_i2c_addr(int);
extern int get_mux();
extern char *i2c_dev;
```

## src/irps5401.c
```c
#include <stdlib.h>
#include <sys/byteorder.h>


#include <zephyr/device.h>
#include <zephyr/drivers/i2c.h>
#include <drivers/gpio.h>
#include <zephyr/zephyr.h>
#include <zephyr/shell/shell.h>
#include "lib.h"
#include "pmbus.h"
#include "irps5401.h"
#include "pmbus_cmds.h"
#include "vrails.h"
#include "i2c.h"
#include <errno.h>
#include <string.h>
#include <math.h>

struct pm_list {
	unsigned char getcmd;
//	unsigned char setcmd;
	int size;
	char *name;
	char *units;
	int type;
} pm_info [] = {
	{PMBUS_READ_VOUT, 2, "Output Voltage", "Volts", PM_LINEAR8},
	{PMBUS_READ_IOUT, 2, "Output Current", "Amps", PM_LINEAR11},
	{PMBUS_READ_TEMPERATURE_1, 2, "Temperature", "Degrees C", PM_LINEAR11},
	{PMBUS_TON_RISE, 2, "Output Voltage Rise Time", "mSec", PM_LINEAR2},
	{PMBUS_POWER_GOOD_ON, 2, "Power Good On", "Volts", PM_LINEAR8},
	{PMBUS_POWER_GOOD_OFF, 2, "Power Good Off", "Volts", PM_LINEAR8},
	{}
};

struct mapping {
	char *name;
	int val;
};

int
irps_setpage(int bus, unsigned char page)
{
	unsigned char read_page;

	// printk("setting to page %d, bus=%d\n", page, bus);
	pmbus_write(bus, PMBUS_PAGE, 1, &page);

	pmbus_read(bus, PMBUS_PAGE, 1, &read_page);

	if (page != read_page) {
		printk("bus: %d, Failed to set page to %d (read back %d instead)\n",
			   bus, page, read_page);
		return -EIO;
	}
	return read_page;
}

int
irps_reg(int rail, struct pmbus_op *p)
{
	int bus = get_bus(rail);
	char	data[8];
	int		val;
	double	fval;
	unsigned short v;

	if (bus < 0) {
		// printk("pmbus_get_vout: Ret err\n");
		return -1;
	}

	int type = vrail[rail].type;
	if (type & ISIRPS_CHIP) {
		irps_setpage(bus, (unsigned char)type&LOOP_MASK);
	}

	if (p->mode == PMWRITE) {
		if (p->rawmode) {
			val = strtol(p->value, NULL, 16);
			// printk("data (raw) - 0x%x\n", val);
		} else {
			// printk("data str: --%s--\n", p->value);
			fval = atof(p->value);
			// printk("data (float) - %s\n", f2str(fval, 2));
			val = encode(fval, p->encoding);
			// printk("data (raw) - 0x%x\n", val);
		}
		data[1] = (val >> 8) & 0xff;
		data[0] = val & 0xff;
		//data[1] = 0xf0;
		// printk("irps setting rail: %d, reg: 0x%x, value: 0x%x 0x%x\n", rail, p->reg, data[0], data[1]);
		pmbus_write(bus, p->reg, p->size, data);
	} else {
		// printk("irps getting rail: %d, reg: 0x%x\n", rail, p->reg);
		pmbus_read(bus, p->reg, p->size, data);
		// printk("got data: 0x%x 0x%x\n", data[0], data[1]);
		v = toshort(data);
		fval = decode(v, p->encoding);
		printk("Reg: 0x%x, Value: %s\n", p->reg, f2str(fval, 4));
	}
	return 0;
}


/*
 * Mode setting, ON or OFF
 */
int
irps_setop(int bus, int rail, int mode)
{
	unsigned char byte;
	if (mode == VOLT_ON) {
		byte = 0x80;
	} else if (mode == VOLT_OFF) {
		byte = 0;
	} else {
		printk("Bad mode\n");
		return -EINVAL;
	}
	if (irps_setpage(bus, rail) < 0) {
		printk("Can't set page %d\n", rail);
		return -EIO;
	}
	return pmbus_write(bus, PMBUS_OPERATION, 1, &byte);
}


/*
 * Assume page is set already
 */
static int
dumpval(int bus, struct pm_list *p, int rail)
{
	unsigned char id[8];
	unsigned short v;
	//printk("Read cmd: 0x%x, sz: 0x%x\n", p->getcmd, p->size);
	pmbus_read(bus, p->getcmd, p->size, id);
	//printk("read 0x%02x 0x%02x\n", id[0], id[1]);
		  
	v = toshort(id);
	if ((p->getcmd == PMBUS_READ_VOUT) && (rail == VDD_1R0)) {
		v /= 2;
	}

	//printk("Got 0x%x for value for %s type=%d units=%s\n", v, p->name, p->type, p->units);
	switch (p->type) {
	case PM_LINEAR8:
	case PM_LINEAR11:
	case PM_LINEAR2:
	case PM_IOUT:
		printk("  %s: %s %s\n", p->name, f2str(decode(v, p->type), 4), p->units);
		break;
	default:
		if (p->size == 1)
			printk("  %s = 0x%02x\n", p->name, v & 0xff);
		else
			printk("  %s = 0x%04x\n", p->name, v);
		break;
	}

	return 0;
}

static int allrails[] = { VDD_0R85, VDD_2R5, VDD_0R9, VDD_1R8, VDD_1R0, -1 };


static int
dumpone(int rail)
{
	struct pm_list *p;
	int bus = IRPS_BUS;
	int type;

	type = vrail[rail].type;
	if (irps_setpage(bus, (unsigned char)type&LOOP_MASK) < 0) {
		printk("Can't set page %d\n", rail);
		return -EIO;
	}
	printk("Rail: %s\n", vrail[rail].signame);
	for (p = pm_info; p->name; p++) {
		if ((rail == VDD_1R0) && (p->getcmd == PMBUS_TON_RISE)) {
		printk("  ----Rise time not supported on LD0---\n");
		} else {
			dumpval(bus, p, rail);
		}
	}
	return 0;
}

static int
dumpall(int rail)
{
	int i;

	if (rail != NUM_RAILS) {
		return dumpone(rail);
	}

	for (i = 0; allrails[i] != -1; i++) {
		dumpone(allrails[i]);
	}
	return 0;
}

int map(char *s, struct mapping *p)
{
	s = toLower(s);
	for (; p->name != NULL; p++) {
		if (strcmp(s, p->name) == 0) {
			return p->val;
		}
	}

	return -1;
}

struct mapping pstates[] = {
	{"0", VOLT_OFF},
	{"off", VOLT_OFF},
	{"1", VOLT_ON},
	{"on", VOLT_ON},
	{NULL,0}
};

static int getpstate(char *s)
{
	return map(s, pstates);
}

struct mapping looptab[] = {
	{"0", VDD_0R85},
	{"1", VDD_2R5},
	{"2", VDD_0R9},
	{"3", VDD_1R8},
	{"4", VDD_1R0},
	{"a", VDD_0R85},
	{"b", VDD_2R5},
	{"c", VDD_0R9},
	{"d", VDD_1R8},
	{"ldo", VDD_1R0},
	{"all", NUM_RAILS},
	{NULL,0}
};

static int
getrail(char *s)
{
	return map(s, looptab);
}

static int
irps_help(const struct shell *sh, size_t argc, char **argv)
{
	ARG_UNUSED(argc);
	ARG_UNUSED(argv);

	printk("\nirps usage:\n");

	printk("irps <dev> [on|off] - Turn device on/off\n");
	printk("irps <dev> dump - dump data associated with rail/loop\n");
	printk("dev may be:\n");
	printk("all - apply to all devices\n");
	printk("[0-4] - devices 0-4, Loops A-D, Loop LDO\n");
	printk("A|B|C|D|LDO (case insensitive)\n");
	return 0;
}

static int
irps_dump(const struct shell *sh, size_t argc, char **argv)
{
	char *dev = toLower(argv[1]);
	int rail;
	
	//printk("\nDumping Device %s\n", dev);

	rail = getrail(dev);
	//printk("rail = %d\n", rail);
	if (rail < 0) {
		printk("Bad rail %s\n", dev);
		return -1;
	}

	dumpall(rail);
#if 0
	double v;
	v = pmread_vout(0x40, rail);
	printk("V: %.4f\n", v);
#endif
	return 0;
}
static int
irps_main(const struct shell *sh, size_t argc, char **argv)
{
	int rail;
	int val;

	char *dev = toLower(argv[1]);
	char *state = toLower(argv[2]);

	rail = getrail(dev);
	printk("irps_main, rail=%d\n", rail);
	if (rail < 0) {
		printk("Command error: Bad rail %s\n", dev);
		return -1;
	}

	val = getpstate(state);
	
	if (val < 0) {
		printk("Command error: Bad power state %s\n", state);
		return -1;
	}
	printk("\nturning rail %s (%d) %s\n", dev, rail, state);
	irps_setop(IRPS_BUS, vrail[rail].type & LOOP_MASK, val);

	return 0;
}

			  
/******************************************************************
 * IRPS commands
 * irps help
 * irps <dev> [on|offp]
 * irps dump <dev>
 *
 * dev: 0-4, a-d, ldo, all
 */
SHELL_SUBCMD_SET_CREATE(sub_irps, (irps));
SHELL_SUBCMD_ADD((irps), help, NULL, "help for irps", irps_help, 1, 0);
SHELL_SUBCMD_ADD((irps), dump, NULL, "Dump Info", irps_dump, 2, 0);
//SHELL_CMD_REGISTER(irps, &sub_irps, "IRPS 5401 Commands", NULL);
SHELL_CMD_ARG_REGISTER(irps, &sub_irps, "IRPS 5401 Commands", irps_main, 1, 3);
```

## src/irps5401.h
```c
#ifndef __IRPS5401_H
#define __IRPS5401_H

#include <zephyr/sys/util_macro.h>


enum irps5401_registers {
	PMBUS_MFR_REG_ACCESS			= 0xD0, /* Block Write, R word */
	PMBUS_MFR_I2C_ADDRESS			= 0xD6, /* R/W byte */
	PMBUS_MFR_TPGDLY				= 0xD8, /* R/W word */
	PMBUS_MFR_FCCM					= 0xD9, /* R/W word */
	PMBUS_MFR_VOUT_PEAK				= 0xDB, /* R/W word */
	PMBUS_MFR_IOUT_PEAK				= 0xDC, /* R/W word */
	PMBUS_MFR_TEMPERATURE_PEAK		= 0xDD, /* R/W word */
	PMBUS_MFR_LDO_MARGIN			= 0xDE, /* R/W word */
};

#define LOOPA	0
#define LOOPB	1
#define LOOPC	2
#define LOOPD	3
#define LOOPLDO 4

extern int irps_setpage(int, unsigned char);
extern int irps_setop(int, int, int);
extern int irps_reg(int, struct pmbus_op *);

#endif /* __IRPS5401_H */
```

## src/led.c
```c
#include <stdlib.h>
#include <string.h>
#include <stdio.h>
#include <sys/byteorder.h>
#include "i2c.h"

#include "shell.h"
#include "lib.h"

/*
 * Control individual LEDs (0-7)
 *
 * led LED <on|green|yellow|off>
 * LED: D8, D9, D10, D11
 * on is both LEDS on
 * D8 is closest to board, D11 furthest
 */
struct lmap {
	char *name;
	int  ypin; /* yellow */
	int  gpin; /* green */
	unsigned char mask; /* mask bits */
} ledmap[] = {
	{"d8", 3, 2, 0x0c},
	{"d9", 1, 0, 0x03},
	/* {"d10", 1, 0, 0xfc}, */
	/* {"d11", 6, 7, 0x3f}, */
	{0, 0, 0, 0}
};

/*
 * real work done here...
 */
static int
led_work(int argc, char **argv)
{
	char s[10];
	char buf[20];

	struct lmap *p;
	char *name = 0;
	int ypin = 0, gpin = 0;
	char gval = 0, tmp;
	unsigned char mask = 0;
	int all = 0;
	char gall = 0, yall = 0, allmask = 0;
	int val;

	if (argc < 2) {
		printf("usage: led <NAME> <STATE>\n");
		printf("NAME: [d8|d9|all]  (Case insensitive)\n");
		printf("STATE: [G|Y|on|off\n");
		return 0;
	}
	p = &ledmap[0];
	strcpy(s, toLower(argv[0]));
	for (; p->name != NULL; p++) {
		if (strcmp(p->name, s) == 0 ) {
			name = p->name;
			ypin = p->ypin;
			gpin = p->gpin;
			mask = p->mask;
		}
		gall |= (1 << p->gpin);
		yall |= (1 << p->ypin);
		allmask |= p->mask;
	}
	if (!name) {
		if (s[0] == 'a') {
			all = 1;
			name = "all";
		} else {
			printf("Not found: %s\n", s);
			return -ENOENT;
		}
	}
#if 0
	printf("name: %s, ypin=%d, gpin=%d, mask=0x%x\n", name, ypin, gpin, mask);
	printf("yall=0x%x, gall = 0x%x, allmask = 0x%02x\n", yall, gall, allmask);
#endif
	strcpy(s, toLower(argv[1]));
	switch (s[0]) {
	case 'g':
		if (all)
			gval = gall;
		else
			gval = 1 << gpin;
		break;
	case 'y':
		if (all)
			gval = yall;
		else
			gval = 1 << ypin;
		break;
	case 'o':
		if (s[1] == 'n') {	/* on */
			if (all)
				gval |= (gall|yall);
			else
				gval = (1 << gpin) | (1 << ypin);
			break;
		} else if (s[1] == 'f') {
			gval = 0;
			break;
		} else {
			printf("Bad option: %s\n", s);
			return -ENOENT;
		}
	default:
		printf("Bad option: %s\n", s);
		return -ENOENT;

	}

	if (all)
		mask = allmask;

#if 0
	printf("gval = 0x%02x\n", gval);
	printf("mask = 0x%02x\n", mask);
#endif
	
	/* LED Controller is on I2C Bus 5 */
	set_mux(LED_BUS);

	/* Set all pins to output */	
	buf[0] = 0xff;
	i2c_write_bytes(LED_ADDR, 3, buf, 1);
	/* High impedence off */
	buf[0] = 0;
	i2c_write_bytes(LED_ADDR, 7, buf, 1);
	/* disbale PU/PD */
	buf[0] = 0;
	i2c_write_bytes(LED_ADDR, 0xb, buf, 1);
	/* write data */

	i2c_read_bytes(LED_ADDR, 5, buf, 1);
#if 0
	printf("read 0x%02x\n", buf[0]);
#endif

	tmp = buf[0];
	val = tmp & ~mask;
	buf[0] = (tmp & ~mask) | gval;
#if 0
	printf("val=0x%x\n", val);
	printf("tmp=0x%x, mask=0x%x, ~mask=0x%x\n", tmp, mask, ~mask);
	printf("writing 0x%02x\n", buf[0]);
#endif
	
	i2c_write_bytes(LED_ADDR, 5, buf, 1);
	printf("\n");
	return 0;
}

static struct command_table led_tab[] = {
	{"d8", led_work, "LED D8 control"},
	{"d9", led_work, "LED D9 control"},
	{"all", led_work, "Control all LEDs"},
	{0}
};

int
led_cmd(int argc, char **argv)
{
	int i;
	char *p = NULL;

#if 0
	printf("run LED submenu...argc = %d\n", argc);
	for ( i = 0; i < argc; i++) {
		printf("arg[%d]: %s\n", i, argv[i]);
	}
#endif
	if (argc > 1) {
		p = malloc(256);
		*p = '\0';
		for (i = 1; i < argc; i++) {
			strcat(p, argv[i]);
			strcat(p, " ");
		}
	} else {
	}
	runcmdlist(led_tab, "led", "LED> ", 1, p);
	if (p)
		free(p);

	//printf("Back...\n");
	return 0;
}
```

## src/lib.c
```c
#include <stdio.h>
#include <stdlib.h>
#include <string.h>
#include <ctype.h>
#include "lib.h"


#include <errno.h>

char *strdup(const char *s)
{
	char *dest = malloc(strlen(s)+1);

	if (dest) {
		strcpy(dest, s);
	}

	return dest;
}

/**
 * C++ version 0.4 char* style "itoa":
 * Written by Lukás Chmela
 * Released under GPLv3.
 */
char* itoa(int value, char* result, int base) {
    // check that the base if valid
    if (base < 2 || base > 36) { *result = '\0'; return result; }

    char *ptr = result, *ptr1 = result, tmp_char;
    int tmp_value;

    do {
        tmp_value = value;
        value /= base;
        *ptr++ = "zyxwvutsrqponmlkjihgfedcba9876543210123456789abcdefghijklmnopqrstuvwxyz" [35 + (tmp_value - value * base)];
    } while ( value );

    // Apply negative sign
    if (tmp_value < 0) *ptr++ = '-';
    *ptr-- = '\0';
    while(ptr1 < ptr) {
        tmp_char = *ptr;
        *ptr--= *ptr1;
        *ptr1++ = tmp_char;
    }
    return result;
}

char* toLower(char* s) {
  for(char *p=s; *p; p++) *p=tolower(*p);
  return s;
}
char* toUpper(char* s) {
  for(char *p=s; *p; p++) *p=toupper(*p);
  return s;
}

/*
 * return char representation of a double, as printf doesn't support %f
 * STILL NEED THISS???? RON
 */
#define NSTR 10
#define SLEN 20
static char __tmpbuf[NSTR*SLEN];
static int fptr = 0;
char *
f2str(double v, int ndec)
{
	char *ptr = &__tmpbuf[SLEN*fptr];

	sprintf(ptr, "%.*f", ndec, v);
	fptr += 1;
	if (fptr >= NSTR)
		fptr = 0;
	return ptr;
}

int
ishex(char *s)
{
	int i, len;
	len = strlen(s);
	if (len > MAX_ARGSZ_INT)
		return -EINVAL;
	for ( i = 0; i < len; i++ )
		if (!isxdigit((int)s[i]))
			return 0;
	return 1;
}

double
mytrunc(double f, int roundto)
{

	int x = (int)f;

	x = x+roundto;
	x = (x/roundto)*roundto;
	return (double) x;
}
unsigned short
toshort(unsigned char *x)
{
	return (unsigned short) ((x[0] << 8) | x[1]);
}

unsigned int
toint(unsigned char *x, int nbytes)
{
	unsigned int rval = 0;
	int i = 0;

	for (i = 0; i < nbytes; i++) {
		rval <<= 8;
		//printf("B: rval=0x%x, x[%d]=0x%x\n", rval, i, x[i]);
		rval |= x[i];
		//printf("A: rval=0x%x\n", rval);
	}			
	//printf("return 0x%x (sz=%d)\n", rval, nbytes);
	return rval;
}
```

## src/lib.h
```c
#include <stdlib.h>

#ifndef __MYLIB_H
#define __MYLIB_H

#define DEV_REINIT	0
#define DEV_SET	1
#define DEF_BUS		"I2C_1"
#define MAX_ARGSZ_INT	8

extern char *i2c_dev;
extern int rail;	/* voltage rail on irps5401 (0-4) */



extern int ishex(char *);
extern char *strdup(const char *);
extern char *itoa(int, char *, int);
extern char *toLower(char *);
extern char *toUpper(char *);
extern unsigned int toint(unsigned char *, int);
extern unsigned short toshort(unsigned char *);
extern double mytrunc(double, int);

extern void setup_dev(int);
extern void setup_pos(void);
extern int set_mux(int);
extern int i2c_write_bytes(int, int, char *, int);
extern int i2c_read_bytes(int, int, char *, int);

#endif /* __MYLIB_H */

#define TRUE	(1==1)
#define FALSE	(1==0)

#define VOLT_ON		1
#define VOLT_OFF	0

#define SET_ALL			-1
#define SET_POR			0
#define SET_SRST		1
#define SET_PROG		2
#define SET_FPGA_PSD	3

#define GET_DONE_B		0
#define GET_INIT		1
#define GET_FPGA_PSD	2

#define ENOENT		2
extern void set_ps_bit(int, int);
extern int get_ps_stat(int);
extern void start_cpu();
extern void set_psbits_hi();
extern char *f2str(double, int);

extern int i2c_write_bytes(int, int, char *, int);
extern int i2c_read_bytes(int, int, char *, int);
```
